/dts-v1/;

/ {
	#address-cells = <0x2>;
	#size-cells = <0x2>;
	compatible = "mediatek,MT6765";
	interrupt-parent = <0x1>;
	model = "MT6765";

	__symbols__ {
		DPIDLE = "/cpus/idle-states/dpidle";
		MCDI_CLUSTER = "/cpus/idle-states/mcdi-cluster";
		MCDI_CPU = "/cpus/idle-states/mcdi-cpu";
		SODI = "/cpus/idle-states/sodi";
		SODI3 = "/cpus/idle-states/sodi3";
		STANDBY = "/cpus/idle-states/standby";
		SUSPEND = "/cpus/idle-states/suspend";
		accdet = "/accdet";
		apdma = "/dma-controller@11000580";
		apmixed = "/apmixed@1000c000";
		audgpio = "/mt_soc_dl1_pcm@11220000";
		audio = "/audio@11220000";
		auxadc = "/auxadc@11001000";
		bat_gm30 = "/battery";
		camsys = "/camsys@1a000000";
		charger = "/charger";
		chosen = "/chosen";
		clk26m = "/clocks/clk26m";
		clk32k = "/clocks/clk32k";
		consys = "/consys@18002000";
		cpu0 = "/cpus/cpu@000";
		cpu1 = "/cpus/cpu@001";
		cpu2 = "/cpus/cpu@002";
		cpu3 = "/cpus/cpu@003";
		cpu4 = "/cpus/cpu@100";
		cpu5 = "/cpus/cpu@101";
		cpu6 = "/cpus/cpu@102";
		cpu7 = "/cpus/cpu@103";
		cpu_dbgapb = "/cpu_dbgapb@0d410000";
		disp_color0 = "/disp_color0@1400f000";
		disp_mutex0 = "/disp_mutex0@14001000";
		dsi_te = "/dsi_te";
		flashlight_core = "/flashlight_core";
		flashlights_mt6370 = "/flashlights_mt6370";
		gce = "/gce@10238000";
		gce_mbox = "/gce_mbox@10238000";
		gic = "/interrupt-controller@0c000000";
		goodix_fp = "/fingerprint";
		gpio = "/gpio@10005000";
		gpio_usage_mapping = "/gpio";
		i2c0 = "/i2c0@11007000";
		i2c1 = "/i2c1@11008000";
		i2c2 = "/i2c2@11009000";
		i2c3 = "/i2c3@1100f000";
		i2c4 = "/i2c4@11011000";
		i2c5 = "/i2c5@11016000";
		i2c6 = "/i2c6@1100d000";
		i2c7 = "/i2c7";
		i2c8 = "/i2c8";
		i2c9 = "/i2c9";
		i2c_common = "/i2c_common";
		imgsys = "/imgsys@15020000";
		infracfg_ao = "/infracfg_ao@10001000";
		iommu = "/m4u@10205000";
		irq_nfc = "/irq_nfc";
		irtx_pwm = "/irtx_pwm";
		kd_camera_hw1 = "/kd_camera_hw1@1a040000";
		keypad = "/kp@10010000";
		lk_charger = "/lk_charger";
		main_pmic = "/pwrap@1000d000/pmic_irq";
		md1_sim1_hot_plug_eint = "/md1_sim1_hot_plug_eint";
		md1_sim2_hot_plug_eint = "/md1_sim2_hot_plug_eint";
		mdcldma = "/mdcldma@10014000";
		mdp_ccorr = "/mdp_ccorr0@14005000";
		mdp_rdma0 = "/mdp_rdma0@14004000";
		mdp_rsz0 = "/mdp_rsz0@14006000";
		mdp_rsz1 = "/mdp_rsz1@14007000";
		mdp_tdshp0 = "/mdp_tdshp0@1400a000";
		mdp_wdma0 = "/mdp_wdma0@14008000";
		mdp_wrot0 = "/mdp_wrot0@14009000";
		mfg_cfg = "/mfg_cfg@13ffe000";
		mipi_rx_ana_csi0a = "/mipi_rx_ana_csi0a@11c10000";
		mipi_rx_ana_csi0b = "/mipi_rx_ana_csi0b@11c11000";
		mipi_rx_ana_csi1a = "/mipi_rx_ana_csi1a@11c12000";
		mipi_rx_ana_csi1b = "/mipi_rx_ana_csi1b@11c13000";
		mipi_rx_ana_csi2a = "/mipi_rx_ana_csi2a@11c14000";
		mipi_rx_ana_csi2b = "/mipi_rx_ana_csi2b@11c15000";
		mmsys_config = "/mmsys_config@14000000";
		mrdump_ext_rst = "/mrdump_ext_rst";
		msdc0 = "/msdc@11230000";
		msdc0_pins_default = "/pinctrl@1000b000/msdc0@default";
		msdc0_pins_hs200 = "/pinctrl@1000b000/msdc0@hs200";
		msdc0_pins_hs400 = "/pinctrl@1000b000/msdc0@hs400";
		msdc0_register_setting_default = "/pinctrl@1000b000/msdc0@register_default";
		msdc1 = "/msdc@11240000";
		msdc1_ins = "/msdc1_ins@0";
		msdc1_pins_ddr50 = "/pinctrl@1000b000/msdc1@ddr50";
		msdc1_pins_default = "/pinctrl@1000b000/msdc1@default";
		msdc1_pins_sdr104 = "/pinctrl@1000b000/msdc1@sdr104";
		msdc1_pins_sdr50 = "/pinctrl@1000b000/msdc1@sdr50";
		msdc1_register_setting_default = "/pinctrl@1000b000/msdc1@register_default";
		msdc2 = "/msdc@11250000";
		msdc3 = "/msdc@11260000";
		msdc3_pins_default = "/pinctrl@1000b000/msdc3@default";
		msdc3_register_setting_default = "/pinctrl@1000b000/msdc3@register_default";
		mt6370_pmu = "/mt6370_pmu_dts";
		mt6370_typec = "/type_c_port0";
		mt_charger = "/mt_charger";
		mt_pmic_vaud28_ldo_reg = "/mt_pmic_regulator/ldo_regulators/ldo_vaud28";
		mt_pmic_vaux18_ldo_reg = "/mt_pmic_regulator/ldo_regulators/ldo_vaux18";
		mt_pmic_vcama_ldo_reg = "/mt_pmic_regulator/ldo_regulators/ldo_vcama";
		mt_pmic_vcamd_ldo_reg = "/mt_pmic_regulator/ldo_regulators/ldo_vcamd";
		mt_pmic_vcamio_ldo_reg = "/mt_pmic_regulator/ldo_regulators/ldo_vcamio";
		mt_pmic_vcn18_ldo_reg = "/mt_pmic_regulator/ldo_regulators/ldo_vcn18";
		mt_pmic_vcn28_ldo_reg = "/mt_pmic_regulator/ldo_regulators/ldo_vcn28";
		mt_pmic_vcn33_bt_ldo_reg = "/mt_pmic_regulator/ldo_regulators/ldo_vcn33_bt";
		mt_pmic_vcn33_wifi_ldo_reg = "/mt_pmic_regulator/ldo_regulators/ldo_vcn33_wifi";
		mt_pmic_vcore_buck_reg = "/mt_pmic_regulator/buck_regulators/buck_vcore";
		mt_pmic_vdram_ldo_reg = "/mt_pmic_regulator/ldo_regulators/ldo_vdram";
		mt_pmic_vefuse_ldo_reg = "/mt_pmic_regulator/ldo_regulators/ldo_vefuse";
		mt_pmic_vemc_ldo_reg = "/mt_pmic_regulator/ldo_regulators/ldo_vemc";
		mt_pmic_vfe28_ldo_reg = "/mt_pmic_regulator/ldo_regulators/ldo_vfe28";
		mt_pmic_vibr_ldo_reg = "/mt_pmic_regulator/ldo_regulators/ldo_vibr";
		mt_pmic_vio18_ldo_reg = "/mt_pmic_regulator/ldo_regulators/ldo_vio18";
		mt_pmic_vio28_ldo_reg = "/mt_pmic_regulator/ldo_regulators/ldo_vio28";
		mt_pmic_vldo28_ldo_reg = "/mt_pmic_regulator/ldo_regulators/ldo_vldo28";
		mt_pmic_vmc_ldo_reg = "/mt_pmic_regulator/ldo_regulators/ldo_vmc";
		mt_pmic_vmch_ldo_reg = "/mt_pmic_regulator/ldo_regulators/ldo_vmch";
		mt_pmic_vmodem_buck_reg = "/mt_pmic_regulator/buck_regulators/buck_vmodem";
		mt_pmic_vpa_buck_reg = "/mt_pmic_regulator/buck_regulators/buck_vpa";
		mt_pmic_vproc_buck_reg = "/mt_pmic_regulator/buck_regulators/buck_vproc";
		mt_pmic_vrf12_ldo_reg = "/mt_pmic_regulator/ldo_regulators/ldo_vrf12";
		mt_pmic_vrf18_ldo_reg = "/mt_pmic_regulator/ldo_regulators/ldo_vrf18";
		mt_pmic_vs1_buck_reg = "/mt_pmic_regulator/buck_regulators/buck_vs1";
		mt_pmic_vsim1_ldo_reg = "/mt_pmic_regulator/ldo_regulators/ldo_vsim1";
		mt_pmic_vsim2_ldo_reg = "/mt_pmic_regulator/ldo_regulators/ldo_vsim2";
		mt_pmic_vsram_others_ldo_reg = "/mt_pmic_regulator/ldo_regulators/ldo_vsram_others";
		mt_pmic_vsram_proc_ldo_reg = "/mt_pmic_regulator/ldo_regulators/ldo_vsram_proc";
		mt_pmic_vusb33_ldo_reg = "/mt_pmic_regulator/ldo_regulators/ldo_vusb33";
		mt_pmic_vxo22_ldo_reg = "/mt_pmic_regulator/ldo_regulators/ldo_vxo22";
		mtkfb = "/mtkfb@0";
		nfc = "/nfc";
		odm = "/odm";
		otg_iddig = "/otg_iddig";
		pericfg = "/pericfg@10003000";
		pio = "/pinctrl@1000b000";
		pmic_clock_buffer_ctrl = "/pmic_clock_buffer_ctrl";
		pwm = "/pwm@11006000";
		reserved_memory = "/reserved-memory";
		rt9465_slave_chr = "/rt9465_slave_chr";
		scpsys = "/scpsys@10001000";
		smart_pa = "/smart_pa";
		smi_larb0 = "/smi_larb0@14003000";
		smi_larb1 = "/smi_larb1@17010000";
		smi_larb2 = "/smi_larb2@15021000";
		smi_larb3 = "/smi_larb3@1a002000";
		spi0 = "/spi@1100a000";
		spi1 = "/spi@11010000";
		spi2 = "/spi@11012000";
		spi3 = "/spi@11013000";
		spi4 = "/spi@11014000";
		spi5 = "/spi@11015000";
		subpmic_pmu_eint = "/mt6370_pmu_eint";
		swtp = "/swtp";
		syscfg_pctl_0 = "/syscfg_pctl_0@10005000";
		syscfg_pctl_1 = "/syscfg_pctl_1@0x10002000";
		syscfg_pctl_2 = "/syscfg_pctl_2@0x10002200";
		syscfg_pctl_3 = "/syscfg_pctl_3@0x10002400";
		syscfg_pctl_4 = "/syscfg_pctl_4@0x10002600";
		syscfg_pctl_5 = "/syscfg_pctl_5@0x10002800";
		syscfg_pctl_6 = "/syscfg_pctl_6@0x10002a00";
		syscfg_pctl_7 = "/syscfg_pctl_7@0x10002c00";
		sysirq = "/intpol-controller@10200a80";
		tcpc_pd = "/mt6370_pd_eint";
		topckgen = "/topckgen@10000000";
		touch = "/touch";
		uart0 = "/serial@11020000";
		uart1 = "/serial@11030000";
		venc_gcon = "/venc_gcon@17000000";
	};

	accdet {
		compatible = "mediatek,pmic-accdet";
		linux,phandle = <0x58>;
		phandle = <0x58>;
	};

	aes_top0@10016000 {
		compatible = "mediatek,aes_top0";
		reg = <0x0 0x10016000 0x0 0x1000>;
	};

	ap_ccif0@10209000 {
		compatible = "mediatek,ap_ccif0";
		interrupts = <0x0 0x94 0x8>;
		reg = <0x0 0x10209000 0x0 0x1000>;
	};

	ap_ccif1@1020b000 {
		compatible = "mediatek,ap_ccif1";
		interrupts = <0x0 0x96 0x8>;
		reg = <0x0 0x1020b000 0x0 0x1000>;
	};

	ap_ccif2@1023c000 {
		compatible = "mediatek,ap_ccif2";
		interrupts = <0x0 0x8f 0x8>;
		reg = <0x0 0x1023c000 0x0 0x1000>;
	};

	ap_ccif3@1023e000 {
		compatible = "mediatek,ap_ccif3";
		interrupts = <0x0 0x92 0x8>;
		reg = <0x0 0x1023e000 0x0 0x1000>;
	};

	ap_dma@11000000 {
		compatible = "mediatek,ap_dma";
		interrupts = <0x0 0x61 0x8>;
		reg = <0x0 0x11000000 0x0 0x1000>;
	};

	apcldmain@1021b000 {
		compatible = "mediatek,apcldmain";
		reg = <0x0 0x1021b000 0x0 0x0>;
	};

	apcldmain_ao@10014000 {
		compatible = "mediatek,apcldmain_ao";
		reg = <0x0 0x10014000 0x0 0x400>;
	};

	apcldmamisc@1021b800 {
		compatible = "mediatek,apcldmamisc";
		interrupts = <0x0 0xa5 0x4>;
		reg = <0x0 0x1021b800 0x0 0x0>;
	};

	apcldmamisc_ao@10014800 {
		compatible = "mediatek,apcldmamisc_ao";
		reg = <0x0 0x10014800 0x0 0x400>;
	};

	apcldmaout@1021b400 {
		compatible = "mediatek,apcldmaout";
		reg = <0x0 0x1021b400 0x0 0x0>;
	};

	apcldmaout_ao@10014400 {
		compatible = "mediatek,apcldmaout_ao";
		reg = <0x0 0x10014400 0x0 0x400>;
	};

	apmixed@1000c000 {
		#clock-cells = <0x1>;
		compatible = "mediatek,apmixed", "syscon";
		linux,phandle = <0x40>;
		phandle = <0x40>;
		reg = <0x0 0x1000c000 0x0 0x1000>;
	};

	apxgpt@10008000 {
		clocks = <0x1d>;
		compatible = "mediatek,apxgpt";
		interrupts = <0x0 0xaa 0x8>;
		reg = <0x0 0x10008000 0x0 0x1000>;
	};

	atf_logger {
		compatible = "mediatek,atf_logger";
		interrupts = <0x0 0xf7 0x1>;
	};

	audio@11220000 {
		#clock-cells = <0x1>;
		compatible = "mediatek,audio", "syscon";
		linux,phandle = <0x3f>;
		phandle = <0x3f>;
		reg = <0x0 0x11220000 0x0 0x1000>;
	};

	audio_snd_card {
		compatible = "mediatek,audio_snd_card";
	};

	audio_sram@11221000 {
		compatible = "mediatek,audio_sram";
		reg = <0x0 0x11221000 0x0 0x9000>;
	};

	auxadc@11001000 {
		clock-names = "auxadc-main";
		clocks = <0x24 0x21>;
		compatible = "mediatek,auxadc";
		interrupts = <0x0 0x4c 0x2>;
		linux,phandle = <0x5c>;
		phandle = <0x5c>;
		reg = <0x0 0x11001000 0x0 0x10000>;
	};

	battery {
		CAR_TUNE_VALUE = <0x63>;
		DIFFERENCE_FULLOCV_ITH = <0xfa>;
		EMBEDDED_SEL = <0x1>;
		FG_METER_RESISTANCE = <0x4b>;
		KEEP_100_PERCENT = <0x2>;
		PMIC_MIN_VOL = <0x82dc>;
		PMIC_SHUTDOWN_CURRENT = <0x14>;
		POWERON_SYSTEM_IBOOT = <0x1f4>;
		Q_MAX_SYS_VOLTAGE_BAT0 = <0xd16>;
		Q_MAX_SYS_VOLTAGE_BAT1 = <0xd16>;
		Q_MAX_SYS_VOLTAGE_BAT2 = <0xd16>;
		Q_MAX_SYS_VOLTAGE_BAT3 = <0xd16>;
		R_FG_VALUE = <0xa>;
		SHUTDOWN_1_TIME = <0x3>;
		SHUTDOWN_GAUGE0_VOLTAGE = <0x84d0>;
		TEMPERATURE_T0 = <0x32>;
		TEMPERATURE_T1 = <0x19>;
		TEMPERATURE_T2 = <0xa>;
		TEMPERATURE_T3 = <0x0>;
		TEMPERATURE_T4 = <0xfffffff6>;
		battery0_profile_t0 = <0x0 0xaa5a 0x398 0x12c 0xa9cb 0x398 0x259 0xa943 0x398 0x385 0xa8c1 0x398 0x4b1 0xa848 0x398 0x5de 0xa7d4 0x3b0 0x70a 0xa75d 0x3b3 0x836 0xa6e2 0x39a 0x962 0xa66f 0x3b7 0xa8f 0xa5f8 0x3ad 0xbbb 0xa580 0x3a0 0xce7 0xa50a 0x3bd 0xe14 0xa491 0x3a6 0xf40 0xa41f 0x3a7 0x106c 0xa3b3 0x3c0 0x1199 0xa33d 0x3c0 0x12c5 0xa2ca 0x3c0 0x13f1 0xa258 0x3c0 0x151d 0xa1e6 0x3c0 0x164a 0xa177 0x3c0 0x1776 0xa10b 0x3c0 0x18a2 0xa0a0 0x3c0 0x19cf 0xa035 0x3c0 0x1afb 0x9fc7 0x3c0 0x1c27 0x9f5e 0x3cc 0x1d54 0x9ef9 0x3e8 0x1e80 0x9e93 0x3e8 0x1fac 0x9e33 0x3fb 0x20d8 0x9dd4 0x410 0x2205 0x9d70 0x410 0x2331 0x9d0a 0x3f7 0x245d 0x9cab 0x3f6 0x258a 0x9c56 0x410 0x26b6 0x9c00 0x410 0x27e2 0x9bae 0x425 0x290f 0x9b5b 0x438 0x2a3b 0x9b05 0x438 0x2b67 0x9ab6 0x453 0x2c94 0x9a67 0x480 0x2dc0 0x9a16 0x4b5 0x2eec 0x99c8 0x4d2 0x3018 0x9969 0x4ee 0x3145 0x98f0 0x4be 0x3271 0x9857 0x40f 0x339d 0x97e4 0x3d6 0x34ca 0x9788 0x3c0 0x35f6 0x973c 0x3c0 0x3722 0x96fa 0x3c0 0x384f 0x96b9 0x3a8 0x397b 0x9680 0x3a5 0x3aa7 0x964d 0x3bf 0x3bd3 0x9612 0x3a1 0x3d00 0x95e3 0x3ac 0x3e2c 0x95b6 0x3b8 0x3f58 0x9584 0x39b 0x4085 0x9557 0x3b2 0x41b1 0x952c 0x3b1 0x42dd 0x9502 0x39c 0x440a 0x94de 0x3b8 0x4536 0x94b9 0x3d5 0x4662 0x9495 0x3e8 0x478e 0x9471 0x3e8 0x48bb 0x9454 0x3e8 0x49e7 0x9433 0x3e8 0x4b13 0x9412 0x3ee 0x4c40 0x93fc 0x40a 0x4d6c 0x93e1 0x427 0x4e98 0x93c4 0x438 0x4fc5 0x93a6 0x438 0x50f1 0x937c 0x438 0x521d 0x9334 0x3ed 0x534a 0x92e3 0x398 0x5476 0x92a2 0x398 0x55a2 0x9275 0x3b1 0x56ce 0x9249 0x3c0 0x57fb 0x921d 0x3c0 0x5927 0x91f2 0x3c0 0x5a53 0x91c8 0x3ac 0x5b80 0x91a1 0x3a1 0x5cac 0x9184 0x3be 0x5dd8 0x9160 0x3c0 0x5f05 0x9131 0x3c0 0x6031 0x90f6 0x3bc 0x615d 0x90b4 0x39e 0x6289 0x907f 0x3c5 0x63b6 0x9042 0x3dd 0x64e2 0x8ff3 0x3c0 0x660e 0x8fbf 0x3a3 0x673b 0x8fa8 0x3aa 0x6867 0x8f9f 0x3c6 0x6993 0x8f91 0x3e3 0x6ac0 0x8f7c 0x400 0x6bec 0x8f4c 0x41d 0x6d18 0x8eed 0x438 0x6e44 0x8d96 0x438 0x6f71 0x8bb6 0x472 0x709d 0x8942 0x4e3 0x71c9 0x8613 0x58f 0x72f6 0x7f8e 0xa71 0x7422 0x70b2 0xeb0>;
		battery0_profile_t0_num = <0x64>;
		battery0_profile_t1 = <0x0 0xaa14 0x4d8 0x12c 0xa99a 0x4d8 0x259 0xa91f 0x4d8 0x385 0xa8a3 0x4d8 0x4b1 0xa82a 0x4d8 0x5de 0xa7b6 0x4d8 0x70a 0xa73f 0x4d8 0x836 0xa6c4 0x4da 0x962 0xa651 0x4f7 0xa8f 0xa5da 0x4ed 0xbbb 0xa562 0x4d8 0xce7 0xa4ec 0x4d8 0xe14 0xa47a 0x4d8 0xf40 0xa407 0x4d8 0x106c 0xa395 0x4db 0x1199 0xa328 0x4f9 0x12c5 0xa2b6 0x500 0x13f1 0xa244 0x500 0x151d 0xa1d2 0x500 0x164a 0xa163 0x51c 0x1776 0xa0f7 0x528 0x18a2 0xa08c 0x528 0x19cf 0xa021 0x528 0x1afb 0x9fb9 0x53f 0x1c27 0x9f57 0x55c 0x1d54 0x9efa 0x578 0x1e80 0x9e9a 0x578 0x1fac 0x9e33 0x578 0x20d8 0x9dc8 0x587 0x2205 0x9d5d 0x5c0 0x2331 0x9cf6 0x5e1 0x245d 0x9c90 0x5f0 0x258a 0x9c2e 0x5f3 0x26b6 0x9bd8 0x60f 0x27e2 0x9b86 0x62d 0x290f 0x9b38 0x653 0x2a3b 0x9af1 0x68c 0x2b67 0x9aa2 0x6ab 0x2c94 0x9a4f 0x6b8 0x2dc0 0x99f5 0x6b8 0x2eec 0x9991 0x6b8 0x3018 0x991c 0x65f 0x3145 0x98a1 0x5e1 0x3271 0x9825 0x54f 0x339d 0x97c1 0x4f9 0x34ca 0x976e 0x4d8 0x35f6 0x9728 0x4d8 0x3722 0x96e6 0x4d8 0x384f 0x96ac 0x4d8 0x397b 0x9672 0x4cb 0x3aa7 0x9639 0x4b0 0x3bd3 0x9606 0x4b0 0x3d00 0x95d4 0x4b0 0x3e2c 0x95a4 0x4b0 0x3f58 0x9579 0x4b0 0x4085 0x9553 0x4ca 0x41b1 0x952c 0x4d8 0x42dd 0x9502 0x4dc 0x440a 0x94e6 0x4f8 0x4536 0x94c3 0x500 0x4662 0x949f 0x500 0x478e 0x947b 0x500 0x48bb 0x945e 0x51c 0x49e7 0x9442 0x538 0x4b13 0x9424 0x550 0x4c40 0x9408 0x550 0x4d6c 0x93eb 0x550 0x4e98 0x93d1 0x55c 0x4fc5 0x93bb 0x577 0x50f1 0x9397 0x55a 0x521d 0x936e 0x52b 0x534a 0x9344 0x500 0x5476 0x9321 0x500 0x55a2 0x92f7 0x4e7 0x56ce 0x92cf 0x4d8 0x57fb 0x92a9 0x4d8 0x5927 0x927e 0x4d8 0x5a53 0x925e 0x4d8 0x5b80 0x923f 0x4d8 0x5cac 0x921a 0x4d8 0x5dd8 0x91e9 0x4d8 0x5f05 0x91b3 0x4d8 0x6031 0x917a 0x4dc 0x615d 0x9147 0x4fa 0x6289 0x910a 0x4ea 0x63b6 0x90c4 0x4e3 0x64e2 0x9075 0x500 0x660e 0x9050 0x500 0x673b 0x9039 0x500 0x6867 0x902b 0x506 0x6993 0x901d 0x523 0x6ac0 0x9008 0x558 0x6bec 0x8fce 0x592 0x6d18 0x8f58 0x5c8 0x6e44 0x8dcf 0x5c8 0x6f71 0x8bb8 0x616 0x709d 0x88f0 0x6c5 0x71c9 0x8532 0x800 0x72f6 0x7ca8 0x29b7 0x7422 0x7436 0x1e00>;
		battery0_profile_t1_num = <0x64>;
		battery0_profile_t2 = <0x0 0xaa32 0x9b0 0x12c 0xa9aa 0x9b0 0x259 0xa929 0x9c2 0x385 0xa8ad 0x9d1 0x4b1 0xa834 0x9b5 0x5de 0xa7ba 0x9b0 0x70a 0xa73f 0x9a3 0x836 0xa6c4 0x988 0x962 0xa651 0x988 0xa8f 0xa5df 0x988 0xbbb 0xa56c 0x988 0xce7 0xa4f6 0x988 0xe14 0xa47d 0x96e 0xf40 0xa40b 0x96f 0x106c 0xa39f 0x988 0x1199 0xa329 0x988 0x12c5 0xa2bc 0x99d 0x13f1 0xa24e 0x9b0 0x151d 0xa1dc 0x9b0 0x164a 0xa16d 0x9b0 0x1776 0xa101 0x9c1 0x18a2 0xa096 0x9d8 0x19cf 0xa02b 0x9d8 0x1afb 0x9fc9 0x9ef 0x1c27 0x9f6e 0xa18 0x1d54 0x9f18 0xa52 0x1e80 0x9ebb 0xaa8 0x1fac 0x9e4f 0xac8 0x20d8 0x9dd3 0xac1 0x2205 0x9d44 0xaa4 0x2331 0x9cc7 0xab9 0x245d 0x9c56 0xac8 0x258a 0x9bf3 0xace 0x26b6 0x9bab 0xb07 0x27e2 0x9b64 0xb18 0x290f 0x9b1a 0xb18 0x2a3b 0x9ac9 0xb18 0x2b67 0x9a81 0xb33 0x2c94 0x9a32 0xb40 0x2dc0 0x99d8 0xb30 0x2eec 0x9962 0xaba 0x3018 0x98ef 0xa47 0x3145 0x987d 0x9ca 0x3271 0x980b 0x93b 0x339d 0x97b2 0x8ff 0x34ca 0x9760 0x8d7 0x35f6 0x9714 0x8ba 0x3722 0x96d2 0x89c 0x384f 0x9698 0x898 0x397b 0x965e 0x898 0x3aa7 0x9625 0x898 0x3bd3 0x95f2 0x898 0x3d00 0x95c5 0x8ac 0x3e2c 0x959a 0x8c8 0x3f58 0x956f 0x8e5 0x4085 0x9543 0x8e8 0x41b1 0x951b 0x8f7 0x42dd 0x94f8 0x910 0x440a 0x94d4 0x910 0x4536 0x94af 0x910 0x4662 0x948e 0x91a 0x478e 0x9471 0x937 0x48bb 0x944e 0x938 0x49e7 0x942e 0x948 0x4b13 0x9412 0x966 0x4c40 0x93fc 0x982 0x4d6c 0x93e1 0x971 0x4e98 0x93c7 0x96c 0x4fc5 0x93b1 0x989 0x50f1 0x93a3 0x9a6 0x521d 0x9390 0x9b0 0x534a 0x937b 0x9b7 0x5476 0x9365 0x9d4 0x55a2 0x9349 0x9d8 0x56ce 0x9326 0x9bd 0x57fb 0x92fb 0x988 0x5927 0x92cf 0x988 0x5a53 0x92ae 0x9b1 0x5b80 0x928f 0x9e1 0x5cac 0x926b 0x9fe 0x5dd8 0x9239 0xa1b 0x5f05 0x91ff 0xa38 0x6031 0x91bf 0xa54 0x615d 0x9186 0xa71 0x6289 0x9152 0xaba 0x63b6 0x910e 0xafb 0x64e2 0x90b1 0xb18 0x660e 0x9086 0xb6d 0x673b 0x9067 0xbd5 0x6867 0x9051 0xc4a 0x6993 0x903c 0xcbc 0x6ac0 0x9020 0xd79 0x6bec 0x8fec 0xe93 0x6d18 0x8f8c 0x1000 0x6e44 0x8e1f 0x1101 0x6f71 0x8c08 0x1329 0x709d 0x8932 0x16b8 0x71c9 0x8565 0x1c31 0x72f6 0x7d38 0x33fe 0x7422 0x7238 0x1950>;
		battery0_profile_t2_num = <0x64>;
		battery0_profile_t3 = <0x0 0xaa46 0x1400 0x12c 0xa9b0 0x1400 0x259 0xa920 0x13ee 0x385 0xa898 0x13d1 0x4b1 0xa817 0x13b5 0x5de 0xa79c 0x1398 0x70a 0xa721 0x137b 0x836 0xa6a6 0x135e 0x962 0xa633 0x1341 0xa8f 0xa5c1 0x1338 0xbbb 0xa54c 0x1320 0xce7 0xa4cf 0x12c8 0xe14 0xa45c 0x12c0 0xf40 0xa3ed 0x12c0 0x106c 0xa381 0x12bd 0x1199 0xa30b 0x129f 0x12c5 0xa29e 0x1298 0x13f1 0xa232 0x1298 0x151d 0xa1c7 0x1298 0x164a 0xa159 0x1298 0x1776 0xa0ed 0x1298 0x18a2 0xa083 0x129d 0x19cf 0xa01f 0x12ba 0x1afb 0x9fbf 0x12d7 0x1c27 0x9f67 0x1318 0x1d54 0x9f17 0x138a 0x1e80 0x9eb1 0x13e2 0x1fac 0x9e34 0x13c7 0x20d8 0x9da7 0x136a 0x2205 0x9d0a 0x12f8 0x2331 0x9c82 0x12cf 0x245d 0x9c0b 0x12b2 0x258a 0x9ba2 0x129b 0x26b6 0x9b54 0x12b7 0x27e2 0x9b09 0x12c0 0x290f 0x9abb 0x12ad 0x2a3b 0x9a65 0x1274 0x2b67 0x9a10 0x123a 0x2c94 0x99b5 0x1200 0x2dc0 0x9955 0x11c1 0x2eec 0x98f1 0x116b 0x3018 0x988d 0x10ff 0x3145 0x982d 0x10ad 0x3271 0x97d5 0x108f 0x339d 0x977f 0x1056 0x34ca 0x9732 0x102f 0x35f6 0x96ec 0x1018 0x3722 0x96aa 0x1018 0x384f 0x9670 0x1030 0x397b 0x963a 0x104d 0x3aa7 0x9607 0x1068 0x3bd3 0x95d4 0x1068 0x3d00 0x95a2 0x107c 0x3e2c 0x9572 0x1090 0x3f58 0x9547 0x1090 0x4085 0x951b 0x1090 0x41b1 0x94f3 0x109f 0x42dd 0x94d0 0x10bc 0x440a 0x94ac 0x10d8 0x4536 0x948d 0x110b 0x4662 0x946d 0x113a 0x478e 0x9449 0x1157 0x48bb 0x942c 0x1174 0x49e7 0x9414 0x11a1 0x4b13 0x93fe 0x11db 0x4c40 0x93e8 0x1215 0x4d6c 0x93d9 0x124e 0x4e98 0x93ca 0x1293 0x4fc5 0x93bb 0x12eb 0x50f1 0x93ad 0x1341 0x521d 0x939a 0x1373 0x534a 0x9386 0x13a7 0x5476 0x9378 0x1419 0x55a2 0x9363 0x1473 0x56ce 0x934a 0x14d8 0x57fb 0x932b 0x1546 0x5927 0x9300 0x157f 0x5a53 0x92db 0x160a 0x5b80 0x92b4 0x16ae 0x5cac 0x9288 0x1740 0x5dd8 0x9250 0x17b4 0x5f05 0x9217 0x1856 0x6031 0x91dc 0x191f 0x615d 0x919a 0x19ec 0x6289 0x915a 0x1af8 0x63b6 0x9114 0x1c16 0x64e2 0x90c5 0x1d34 0x660e 0x908a 0x1ecd 0x673b 0x9062 0x2096 0x6867 0x9046 0x2290 0x6993 0x9029 0x24cc 0x6ac0 0x9006 0x27d4 0x6bec 0x8fc4 0x2b9d 0x6d18 0x8f51 0x3027 0x6e44 0x8df2 0x35bd 0x6f71 0x8bd6 0x3e5e 0x709d 0x88f1 0x49cf 0x71c9 0x8517 0x5838 0x72f6 0x7dd4 0x424a 0x7422 0x7468 0x2198>;
		battery0_profile_t3_num = <0x64>;
		battery0_profile_t4 = <0x0 0xaa46 0x3188 0x12c 0xa98c 0x3188 0x259 0xa8e5 0x3153 0x385 0xa84d 0x3117 0x4b1 0xa7b6 0x3133 0x5de 0xa732 0x3090 0x70a 0xa6b0 0x3006 0x836 0xa62d 0x2fc1 0x962 0xa5b3 0x2ef9 0xa8f 0xa53a 0x2e91 0xbbb 0xa4c0 0x2e50 0xce7 0xa443 0x2df8 0xe14 0xa3d0 0x2d54 0xf40 0xa35d 0x2d0f 0x106c 0xa2eb 0x2d28 0x1199 0xa27e 0x2d28 0x12c5 0xa20c 0x2ce8 0x13f1 0xa19a 0x2ca6 0x151d 0xa128 0x2c89 0x164a 0xa0c0 0x2c50 0x1776 0xa05b 0x2c38 0x18a2 0x9ffa 0x2c2d 0x19cf 0x9fa4 0x2bf4 0x1afb 0x9f41 0x2be8 0x1c27 0x9ecf 0x2bd0 0x1d54 0x9e4e 0x2b94 0x1e80 0x9dad 0x2ae4 0x1fac 0x9d0e 0x29eb 0x20d8 0x9c76 0x2918 0x2205 0x9bef 0x2918 0x2331 0x9b7d 0x28ff 0x245d 0x9b14 0x28b7 0x258a 0x9ab2 0x2853 0x26b6 0x9a64 0x286f 0x27e2 0x9a0e 0x284f 0x290f 0x99ba 0x2828 0x2a3b 0x996b 0x2828 0x2b67 0x991c 0x27f2 0x2c94 0x98c9 0x27a9 0x2dc0 0x9872 0x2760 0x2eec 0x9824 0x2760 0x3018 0x97d5 0x274a 0x3145 0x9789 0x272d 0x3271 0x973f 0x2710 0x339d 0x96f8 0x272d 0x34ca 0x96b5 0x275b 0x35f6 0x9676 0x278e 0x3722 0x963b 0x27ac 0x384f 0x9602 0x2798 0x397b 0x95cc 0x27d5 0x3aa7 0x9599 0x2877 0x3bd3 0x9566 0x2859 0x3d00 0x9539 0x2877 0x3e2c 0x9510 0x28c9 0x3f58 0x94ec 0x2958 0x4085 0x94c1 0x29b6 0x41b1 0x949d 0x2a1c 0x42dd 0x9481 0x2a8e 0x440a 0x946c 0x2b01 0x4536 0x9451 0x2b60 0x4662 0x9439 0x2bc1 0x478e 0x942b 0x2c34 0x48bb 0x9415 0x2d30 0x49e7 0x9404 0x2dd1 0x4b13 0x93f5 0x2e3a 0x4c40 0x93e7 0x2ee6 0x4d6c 0x93d9 0x2fa8 0x4e98 0x93c7 0x305b 0x4fc5 0x93b1 0x30ef 0x50f1 0x93a3 0x31b7 0x521d 0x9390 0x32cd 0x534a 0x937a 0x33f6 0x5476 0x9365 0x34db 0x55a2 0x934f 0x35d9 0x56ce 0x9336 0x36f9 0x57fb 0x9318 0x3841 0x5927 0x92f4 0x39b4 0x5a53 0x92d1 0x3b3c 0x5b80 0x92aa 0x3cd0 0x5cac 0x927e 0x3e6a 0x5dd8 0x924d 0x4031 0x5f05 0x9217 0x41fb 0x6031 0x91dc 0x43cf 0x615d 0x919a 0x45de 0x6289 0x915a 0x48c4 0x63b6 0x9114 0x4b81 0x64e2 0x90c5 0x4da1 0x660e 0x908a 0x4fcd 0x673b 0x9062 0x5227 0x6867 0x9044 0x54a9 0x6993 0x9020 0x5757 0x6ac0 0x8ff6 0x59fc 0x6bec 0x8fb3 0x5d0c 0x6d18 0x8f48 0x609f 0x6e44 0x8df8 0x6433 0x6f71 0x8be0 0x69b9 0x709d 0x892f 0x6ca4 0x71c9 0x852c 0x5f8e 0x72f6 0x7db3 0x4189 0x7422 0x7a76 0x3480>;
		battery0_profile_t4_num = <0x64>;
		battery1_profile_t0 = <0x0 0xaa82 0x370 0x12e 0xaa0f 0x370 0x25c 0xa99a 0x370 0x38a 0xa925 0x370 0x4b8 0xa8b2 0x370 0x5e6 0xa83f 0x370 0x714 0xa7c7 0x370 0x842 0xa74b 0x373 0x970 0xa6d8 0x390 0xa9e 0xa660 0x398 0xbcc 0xa5e4 0x398 0xcfa 0xa567 0x398 0xe28 0xa4f4 0x398 0xf56 0xa47d 0x387 0x1084 0xa403 0x376 0x11b2 0xa38d 0x393 0x12e0 0xa31a 0x398 0x140e 0xa2a7 0x398 0x153c 0xa234 0x39a 0x166a 0xa1c6 0x3b7 0x1798 0xa154 0x3c0 0x18c6 0xa0e3 0x3c9 0x19f4 0xa077 0x3e6 0x1b22 0xa002 0x3cd 0x1c50 0x9f96 0x3d0 0x1d7f 0x9f30 0x3e3 0x1ead 0x9ec1 0x3c6 0x1fdb 0x9e5a 0x3d7 0x2109 0x9df6 0x3e8 0x2237 0x9d91 0x3e8 0x2365 0x9d32 0x3e8 0x2493 0x9cd3 0x3fb 0x25c1 0x9c76 0x410 0x26ef 0x9c18 0x410 0x281d 0x9bbf 0x410 0x294b 0x9b68 0x41f 0x2a79 0x9b12 0x43c 0x2ba7 0x9abc 0x459 0x2cd5 0x9a69 0x48c 0x2e03 0x9a10 0x4bb 0x2f31 0x99ac 0x4d8 0x305f 0x9923 0x481 0x318d 0x9894 0x406 0x32bb 0x9810 0x398 0x33e9 0x97ba 0x398 0x3517 0x976a 0x398 0x3645 0x9721 0x398 0x3773 0x96df 0x398 0x38a1 0x96a6 0x398 0x39cf 0x966c 0x398 0x3afd 0x9632 0x398 0x3c2b 0x95f7 0x398 0x3d59 0x95c5 0x398 0x3e87 0x9597 0x398 0x3fb5 0x956a 0x398 0x40e3 0x9536 0x398 0x4211 0x9510 0x3b0 0x433f 0x94e9 0x3c0 0x446d 0x94be 0x3c0 0x459b 0x9499 0x3c0 0x46c9 0x9475 0x3c0 0x47f7 0x9451 0x3c0 0x4925 0x942d 0x3c0 0x4a53 0x940f 0x3db 0x4b81 0x93f2 0x3e8 0x4caf 0x93d5 0x3ed 0x4ddd 0x93b8 0x40a 0x4f0b 0x9395 0x410 0x5039 0x9368 0x3f8 0x5167 0x932e 0x3c0 0x5295 0x92e4 0x3c0 0x53c3 0x92a5 0x3ad 0x54f1 0x9272 0x3a0 0x561f 0x924e 0x3bd 0x574d 0x9223 0x3c0 0x587c 0x91f7 0x3b1 0x59aa 0x91cd 0x39c 0x5ad8 0x91a9 0x3b9 0x5c06 0x9184 0x3aa 0x5d34 0x9160 0x3a3 0x5e62 0x913c 0x3c0 0x5f90 0x9102 0x3c0 0x60be 0x90c3 0x3c0 0x61ec 0x9081 0x3c0 0x631a 0x9041 0x3c0 0x6448 0x8fed 0x3a7 0x6576 0x8fb2 0x398 0x66a4 0x8f97 0x398 0x67d2 0x8f90 0x398 0x6900 0x8f89 0x3c2 0x6a2e 0x8f7f 0x406 0x6b5c 0x8f70 0x45e 0x6c8a 0x8f31 0x460 0x6db8 0x8e64 0x44f 0x6ee6 0x8d0a 0x444 0x7014 0x8aff 0x47f 0x7142 0x883d 0x519 0x7270 0x843c 0x6af 0x739e 0x7e81 0xc6a 0x74cc 0x709e 0xeb0>;
		battery1_profile_t0_num = <0x64>;
		battery1_profile_t1 = <0x0 0xaa50 0x488 0x12e 0xa9dd 0x488 0x25c 0xa968 0x488 0x38a 0xa8f1 0x488 0x4b8 0xa877 0x488 0x5e6 0xa7fd 0x488 0x714 0xa785 0x488 0x842 0xa70f 0x48b 0x970 0xa69c 0x4a8 0xa9e 0xa624 0x49b 0xbcc 0xa5a8 0x488 0xcfa 0xa52b 0x488 0xe28 0xa4b8 0x488 0xf56 0xa445 0x499 0x1084 0xa3d1 0x4b0 0x11b2 0xa35b 0x4b0 0x12e0 0xa2e8 0x4b0 0x140e 0xa278 0x4bd 0x153c 0xa20c 0x4d6 0x166a 0xa196 0x4b9 0x1798 0xa127 0x4c4 0x18c6 0xa0bb 0x4e1 0x19f4 0xa04f 0x4fe 0x1b22 0x9fe1 0x500 0x1c50 0x9f78 0x510 0x1d7f 0x9f1a 0x537 0x1ead 0x9edf 0x58f 0x1fdb 0x9e88 0x589 0x2109 0x9e0d 0x560 0x2237 0x9d68 0x529 0x2365 0x9ccd 0x546 0x2493 0x9c52 0x550 0x25c1 0x9bf2 0x568 0x26ef 0x9bb1 0x5be 0x281d 0x9b7c 0x617 0x294b 0x9b42 0x640 0x2a79 0x9aff 0x648 0x2ba7 0x9ab0 0x682 0x2cd5 0x9a5a 0x6a6 0x2e03 0x99fa 0x6ad 0x2f31 0x998e 0x690 0x305f 0x98fe 0x5e3 0x318d 0x9875 0x546 0x32bb 0x97fa 0x4c9 0x33e9 0x979d 0x490 0x3517 0x9752 0x488 0x3645 0x970d 0x488 0x3773 0x96cb 0x488 0x38a1 0x9692 0x488 0x39cf 0x9658 0x473 0x3afd 0x9621 0x460 0x3c2b 0x95ed 0x460 0x3d59 0x95c2 0x47c 0x3e87 0x9592 0x477 0x3fb5 0x9561 0x460 0x40e3 0x9535 0x460 0x4211 0x9510 0x478 0x433f 0x94ec 0x495 0x446d 0x94c8 0x4b0 0x459b 0x94a3 0x4b0 0x46c9 0x9484 0x4c4 0x47f7 0x9467 0x4d8 0x4925 0x944a 0x4d8 0x4a53 0x942d 0x4f3 0x4b81 0x9410 0x500 0x4caf 0x93f3 0x500 0x4ddd 0x93d6 0x500 0x4f0b 0x93b9 0x500 0x5039 0x939c 0x500 0x5167 0x937f 0x4fe 0x5295 0x935a 0x4c3 0x53c3 0x9331 0x49d 0x54f1 0x930a 0x488 0x561f 0x92ed 0x488 0x574d 0x92c3 0x46e 0x587c 0x9297 0x460 0x59aa 0x926e 0x460 0x5ad8 0x9251 0x460 0x5c06 0x922e 0x460 0x5d34 0x9207 0x46b 0x5e62 0x91dc 0x488 0x5f90 0x919b 0x488 0x60be 0x915e 0x488 0x61ec 0x9121 0x488 0x631a 0x90e1 0x488 0x6448 0x908d 0x488 0x6576 0x9052 0x488 0x66a4 0x9036 0x48b 0x67d2 0x9028 0x4a8 0x6900 0x901a 0x4c5 0x6a2e 0x900b 0x4ec 0x6b5c 0x8ffc 0x527 0x6c8a 0x8fc4 0x560 0x6db8 0x8efa 0x567 0x6ee6 0x8d9c 0x56d 0x7014 0x8b7b 0x601 0x7142 0x8873 0x6c1 0x7270 0x83bb 0xa87 0x739e 0x7cbb 0x16de 0x74cc 0x73a0 0x1950>;
		battery1_profile_t1_num = <0x64>;
		battery1_profile_t2 = <0x0 0xaa8c 0x7d0 0x12e 0xaa19 0x7d0 0x25c 0xa9a0 0x7d0 0x38a 0xa923 0x7d0 0x4b8 0xa8a9 0x7d0 0x5e6 0xa82f 0x7d0 0x714 0xa7b3 0x7d0 0x842 0xa737 0x7d0 0x970 0xa6c4 0x7d0 0xa9e 0xa64c 0x7d0 0xbcc 0xa5d3 0x7d0 0xcfa 0xa55d 0x7d0 0xe28 0xa4e3 0x7d0 0xf56 0xa46d 0x7d0 0x1084 0xa3f9 0x7d0 0x11b2 0xa383 0x7d0 0x12e0 0xa316 0x7e8 0x140e 0xa2a7 0x7f8 0x153c 0xa234 0x7f8 0x166a 0xa1be 0x7f8 0x1798 0xa14f 0x80c 0x18c6 0xa0e3 0x832 0x19f4 0xa077 0x86b 0x1b22 0xa009 0x870 0x1c50 0x9fa8 0x880 0x1d7f 0x9f57 0x8ac 0x1ead 0x9f24 0x922 0x1fdb 0x9ec8 0x967 0x2109 0x9e43 0x970 0x2237 0x9d8f 0x937 0x2365 0x9cd7 0x91a 0x2493 0x9c48 0x923 0x25c1 0x9bd6 0x940 0x26ef 0x9b78 0x95d 0x281d 0x9b3a 0x994 0x294b 0x9aff 0x9bf 0x2a79 0x9ac5 0x9dc 0x2ba7 0x9a84 0x9f9 0x2cd5 0x9a2c 0x9d4 0x2e03 0x99c2 0x977 0x2f31 0x9948 0x8e8 0x305f 0x98cd 0x875 0x318d 0x985a 0x800 0x32bb 0x97f2 0x799 0x33e9 0x979c 0x760 0x3517 0x9752 0x758 0x3645 0x970d 0x74a 0x3773 0x96cb 0x730 0x38a1 0x968a 0x730 0x39cf 0x9654 0x730 0x3afd 0x9621 0x73a 0x3c2b 0x95ed 0x757 0x3d59 0x95bb 0x73c 0x3e87 0x958d 0x741 0x3fb5 0x9561 0x758 0x40e3 0x9535 0x758 0x4211 0x9510 0x770 0x433f 0x94ec 0x780 0x446d 0x94c8 0x782 0x459b 0x94a3 0x79f 0x46c9 0x947f 0x7a8 0x47f7 0x945d 0x7a8 0x4925 0x9440 0x7a8 0x4a53 0x9423 0x7c3 0x4b81 0x9406 0x7d0 0x4caf 0x93ea 0x7d5 0x4ddd 0x93d5 0x7f2 0x4f0b 0x93b9 0x7e1 0x5039 0x93a2 0x7dc 0x5167 0x9393 0x7f8 0x5295 0x937d 0x7f8 0x53c3 0x936c 0x7f8 0x54f1 0x935c 0x7f8 0x561f 0x9346 0x7f8 0x574d 0x931d 0x7de 0x587c 0x92f1 0x7c1 0x59aa 0x92c8 0x7ac 0x5ad8 0x92ab 0x7c9 0x5c06 0x9288 0x7d0 0x5d34 0x925e 0x7db 0x5e62 0x922c 0x7f8 0x5f90 0x91eb 0x815 0x60be 0x91a9 0x820 0x61ec 0x9167 0x82f 0x631a 0x9127 0x868 0x6448 0x90d3 0x889 0x6576 0x9094 0x8a6 0x66a4 0x9072 0x8ca 0x67d2 0x9064 0x921 0x6900 0x9056 0x98c 0x6a2e 0x9045 0xa14 0x6b5c 0x902e 0xac4 0x6c8a 0x8ffd 0xbe2 0x6db8 0x8f3f 0xcbe 0x6ee6 0x8dea 0xda6 0x7014 0x8bc2 0xf7d 0x7142 0x88ad 0x132f 0x7270 0x83cf 0x1cfe 0x739e 0x7c44 0x2cea 0x74cc 0x7242 0x1428>;
		battery1_profile_t2_num = <0x64>;
		battery1_profile_t3 = <0x0 0xaaaa 0xed8 0x12e 0xaa21 0xed8 0x25c 0xa99b 0xed8 0x38a 0xa917 0xed1 0x4b8 0xa896 0xeb4 0x5e6 0xa815 0xe97 0x714 0xa795 0xe7a 0x842 0xa719 0xe60 0x970 0xa6a6 0xe60 0xa9e 0xa62e 0xe60 0xbcc 0xa5b5 0xe56 0xcfa 0xa53f 0xe39 0xe28 0xa4c5 0xe38 0xf56 0xa453 0xe49 0x1084 0xa3e7 0xe60 0x11b2 0xa378 0xe60 0x12e0 0xa306 0xe48 0x140e 0xa296 0xe45 0x153c 0xa22a 0xe60 0x166a 0xa1b4 0xe60 0x1798 0xa145 0xe88 0x18c6 0xa0d9 0xeb0 0x19f4 0xa06d 0xeb0 0x1b22 0xa00c 0xecb 0x1c50 0x9fba 0xef8 0x1d7f 0x9f73 0xf4a 0x1ead 0x9f31 0x1019 0x1fdb 0x9ebb 0x1057 0x2109 0x9e1f 0x1038 0x2237 0x9d5d 0xfc5 0x2365 0x9ca5 0xf6d 0x2493 0x9c0c 0xf29 0x25c1 0x9b90 0xf00 0x26ef 0x9b32 0xf00 0x281d 0x9ae6 0xf1a 0x294b 0x9a9e 0xf19 0x2a79 0x9a55 0xefc 0x2ba7 0x9a06 0xedf 0x2cd5 0x99aa 0xe80 0x2e03 0x9948 0xe16 0x2f31 0x98e4 0xdc0 0x305f 0x987f 0xd4d 0x318d 0x9822 0xd0e 0x32bb 0x97ca 0xce9 0x33e9 0x9774 0xcb0 0x3517 0x9730 0xca8 0x3645 0x96ef 0xca8 0x3773 0x96ad 0xca8 0x38a1 0x9674 0xca8 0x39cf 0x963a 0xca8 0x3afd 0x9603 0xca8 0x3c2b 0x95cf 0xca8 0x3d59 0x95a4 0xcc4 0x3e87 0x9574 0xcd0 0x3fb5 0x9545 0xcd6 0x40e3 0x9520 0xcf3 0x4211 0x94fc 0xd10 0x433f 0x94d8 0xd2d 0x446d 0x94b4 0xd48 0x459b 0x948f 0xd48 0x46c9 0x946b 0xd5c 0x47f7 0x9449 0xd79 0x4925 0x942c 0xd96 0x4a53 0x9416 0xdb3 0x4b81 0x93fc 0xdc0 0x4caf 0x93e0 0xdc5 0x4ddd 0x93cb 0xde2 0x4f0b 0x93bb 0xe16 0x5039 0x93af 0xe44 0x5167 0x93a8 0xe61 0x5295 0x9399 0xe7e 0x53c3 0x9385 0xe88 0x54f1 0x9370 0xe98 0x561f 0x935a 0xed2 0x574d 0x9344 0xef2 0x587c 0x932b 0xf2e 0x59aa 0x930c 0xf80 0x5ad8 0x92e1 0xfba 0x5c06 0x92ba 0x1021 0x5d34 0x928d 0x107f 0x5e62 0x9254 0x10b8 0x5f90 0x9213 0x110f 0x60be 0x91d6 0x119d 0x61ec 0x9196 0x1254 0x631a 0x9147 0x131d 0x6448 0x90f7 0x13ff 0x6576 0x90b9 0x1512 0x66a4 0x908f 0x1663 0x67d2 0x907a 0x1813 0x6900 0x9064 0x1a2b 0x6a2e 0x904c 0x1cc8 0x6b5c 0x902f 0x201f 0x6c8a 0x8fe1 0x247b 0x6db8 0x8f17 0x2953 0x6ee6 0x8dc0 0x2f1d 0x7014 0x8b88 0x3766 0x7142 0x8858 0x4500 0x7270 0x83f1 0x4fc0 0x739e 0x7a81 0x3549 0x74cc 0x74d6 0x20a8>;
		battery1_profile_t3_num = <0x64>;
		battery1_profile_t4 = <0x0 0xaab4 0x2788 0x12e 0xaa16 0x2788 0x25c 0xa97a 0x2788 0x38a 0xa8e2 0x2781 0x4b8 0xa852 0x2764 0x5e6 0xa7c8 0x26e4 0x714 0xa742 0x267c 0x842 0xa6be 0x2638 0x970 0xa644 0x25a8 0xa9e 0xa5ca 0x252d 0xbcc 0xa54e 0x24cc 0xcfa 0xa4d1 0x2492 0xe28 0xa45e 0x2458 0xf56 0xa3eb 0x2440 0x1084 0xa377 0x242f 0x11b2 0xa301 0x23d7 0x12e0 0xa294 0x23e0 0x140e 0xa225 0x23e3 0x153c 0xa1b2 0x23c3 0x166a 0xa144 0x236b 0x1798 0xa0d2 0x2314 0x18c6 0xa068 0x22c6 0x19f4 0xa011 0x228d 0x1b22 0x9fc7 0x22f4 0x1c50 0x9f72 0x2368 0x1d7f 0x9f0b 0x23be 0x1ead 0x9e78 0x2383 0x1fdb 0x9dbf 0x22a6 0x2109 0x9cfd 0x21bc 0x2237 0x9c3c 0x20f5 0x2365 0x9ba8 0x209d 0x2493 0x9b2b 0x2059 0x25c1 0x9abc 0x2028 0x26ef 0x9a57 0x200b 0x281d 0x9a0a 0x2022 0x294b 0x99c2 0x2030 0x2a79 0x9979 0x2028 0x2ba7 0x992a 0x1fee 0x2cd5 0x98d9 0x1fb4 0x2e03 0x9889 0x1f79 0x2f31 0x983a 0x1f40 0x305f 0x97eb 0x1f23 0x318d 0x979f 0x1f18 0x32bb 0x9756 0x1f11 0x33e9 0x970e 0x1ef4 0x3517 0x96cc 0x1f09 0x3645 0x968e 0x1f34 0x3773 0x9653 0x1f65 0x38a1 0x961a 0x1f48 0x39cf 0x95e6 0x1f7f 0x3afd 0x95b5 0x1fc2 0x3c2b 0x9589 0x1fdf 0x3d59 0x9557 0x2018 0x3e87 0x952d 0x2063 0x3fb5 0x9507 0x20ae 0x40e3 0x94db 0x20cb 0x4211 0x94b6 0x2100 0x433f 0x9492 0x213a 0x446d 0x946e 0x2173 0x459b 0x9451 0x21ae 0x46c9 0x9439 0x21d4 0x47f7 0x9423 0x2203 0x4925 0x940e 0x2259 0x4a53 0x93fe 0x22b1 0x4b81 0x93f0 0x22e8 0x4caf 0x93e2 0x2314 0x4ddd 0x93d3 0x2387 0x4f0b 0x93c5 0x23e5 0x5039 0x93b6 0x2455 0x5167 0x93a8 0x24e7 0x5295 0x9399 0x25d3 0x53c3 0x9385 0x2681 0x54f1 0x9370 0x2721 0x561f 0x935a 0x27ea 0x574d 0x933e 0x28ed 0x587c 0x931d 0x2a02 0x59aa 0x92f9 0x2b26 0x5ad8 0x92d5 0x2c62 0x5c06 0x92ab 0x2dd1 0x5d34 0x927c 0x2f63 0x5e62 0x924a 0x3112 0x5f90 0x9210 0x32df 0x60be 0x91d1 0x3531 0x61ec 0x918e 0x3815 0x631a 0x9146 0x3bad 0x6448 0x9104 0x3f5f 0x6576 0x90cd 0x439d 0x66a4 0x90a3 0x4883 0x67d2 0x9086 0x4de8 0x6900 0x9064 0x5377 0x6a2e 0x903d 0x588c 0x6b5c 0x9011 0x5c93 0x6c8a 0x8fb4 0x5fbd 0x6db8 0x8eed 0x625b 0x6ee6 0x8da4 0x64ba 0x7014 0x8b7c 0x679b 0x7142 0x887c 0x6b0a 0x7270 0x83ed 0x5a95 0x739e 0x79c0 0x3289 0x74cc 0x7940 0x3020>;
		battery1_profile_t4_num = <0x64>;
		compatible = "mediatek,bat_gm30";
		g_FG_PSEUDO100_T0 = <0x64>;
		g_FG_PSEUDO100_T1 = <0x64>;
		g_FG_PSEUDO100_T2 = <0x64>;
		g_FG_PSEUDO100_T3 = <0x64>;
		g_FG_PSEUDO100_T4 = <0x64>;
		linux,phandle = <0x5a>;
		phandle = <0x5a>;
	};

	bpi_bsi_slv0@1021e000 {
		compatible = "mediatek,bpi_bsi_slv0";
		reg = <0x0 0x1021e000 0x0 0x1000>;
	};

	bpi_bsi_slv1@1021f000 {
		compatible = "mediatek,bpi_bsi_slv1";
		reg = <0x0 0x1021f000 0x0 0x6000>;
	};

	bpi_bsi_slv2@10225000 {
		compatible = "mediatek,bpi_bsi_slv2";
		reg = <0x0 0x10225000 0x0 0x1000>;
	};

	btcvsd@10001000 {
		compatible = "mediatek,audio_bt_cvsd";
		interrupts = <0x0 0x10a 0x8>;
		offset = <0xf00 0x800 0x140 0x144 0x148>;
		reg = <0x0 0x10001000 0x0 0x1000 0x0 0x18050000 0x0 0x1000 0x0 0x18080000 0x0 0x10000>;
	};

	btif@1100c000 {
		clock-names = "btifc", "apdmac";
		clocks = <0x24 0x1a 0x24 0x26>;
		compatible = "mediatek,btif";
		interrupts = <0x0 0x70 0x8 0x0 0x84 0x8 0x0 0x85 0x8>;
		reg = <0x0 0x1100c000 0x0 0x1000 0x0 0x11000880 0x0 0x80 0x0 0x11000900 0x0 0x80>;
	};

	bus_dbg@10208000 {
		compatible = "mediatek,bus_dbg-v2";
		interrupts = <0x0 0x8d 0x8>;
		mediatek,bus_dbg_con_offset = <0x2fc>;
		reg = <0x0 0x10208000 0x0 0x1000 0x0 0x10001000 0x0 0x1000>;
	};

	cam1@1a003000 {
		compatible = "mediatek,cam1";
		interrupts = <0x0 0xeb 0x8>;
		reg = <0x0 0x1a003000 0x0 0x1000>;
	};

	cam2@1a004000 {
		compatible = "mediatek,cam2";
		interrupts = <0x0 0xec 0x8>;
		reg = <0x0 0x1a004000 0x0 0x1000>;
	};

	cam3@1a005000 {
		compatible = "mediatek,cam3";
		interrupts = <0x0 0xed 0x8>;
		reg = <0x0 0x1a005000 0x0 0x1000>;
	};

	cam_clear@1a01b000 {
		compatible = "mediatek,cam_clear";
		reg = <0x0 0x1a01b000 0x0 0x1000>;
	};

	cam_inner@1a013000 {
		compatible = "mediatek,cam_inner";
		reg = <0x0 0x1a013000 0x0 0x1000>;
	};

	cam_set@1a00b000 {
		compatible = "mediatek,cam_set";
		reg = <0x0 0x1a00b000 0x0 0x1000>;
	};

	cama_clear@1a01c000 {
		compatible = "mediatek,cama_clear";
		reg = <0x0 0x1a01c000 0x0 0x1000>;
	};

	cama_ext@1a024000 {
		compatible = "mediatek,cama_ext";
		reg = <0x0 0x1a024000 0x0 0x1000>;
	};

	cama_inner@1a014000 {
		compatible = "mediatek,cama_inner";
		reg = <0x0 0x1a014000 0x0 0x1000>;
	};

	cama_set@1a00c000 {
		compatible = "mediatek,cama_set";
		reg = <0x0 0x1a00c000 0x0 0x1000>;
	};

	camb_clear@1a01d000 {
		compatible = "mediatek,camb_clear";
		reg = <0x0 0x1a01d000 0x0 0x1000>;
	};

	camb_ext@1a025000 {
		compatible = "mediatek,camb_ext";
		reg = <0x0 0x1a025000 0x0 0x1000>;
	};

	camb_inner@1a015000 {
		compatible = "mediatek,camb_inner";
		reg = <0x0 0x1a015000 0x0 0x1000>;
	};

	camb_set@1a00d000 {
		compatible = "mediatek,camb_set";
		reg = <0x0 0x1a00d000 0x0 0x1000>;
	};

	camsv1@1a050000 {
		compatible = "mediatek,camsv1";
		interrupts = <0x0 0xf3 0x8>;
		reg = <0x0 0x1a050000 0x0 0x1000>;
	};

	camsv2@1a051000 {
		compatible = "mediatek,camsv2";
		interrupts = <0x0 0xf4 0x8>;
		reg = <0x0 0x1a051000 0x0 0x1000>;
	};

	camsv3@1a052000 {
		compatible = "mediatek,camsv3";
		interrupts = <0x0 0xf1 0x8>;
		reg = <0x0 0x1a052000 0x0 0x1000>;
	};

	camsv4@1a053000 {
		compatible = "mediatek,camsv4";
		interrupts = <0x0 0xf2 0x8>;
		reg = <0x0 0x1a053000 0x0 0x1000>;
	};

	camsys@1a000000 {
		#clock-cells = <0x1>;
		compatible = "mediatek,camsys", "syscon";
		linux,phandle = <0x42>;
		phandle = <0x42>;
		reg = <0x0 0x1a000000 0x0 0x1000>;
	};

	ccu@1a0b0000 {
		clock-names = "CCU_CLK_CAM_CCU";
		clocks = <0x42 0x8>;
		compatible = "mediatek,ccu";
		interrupts = <0x0 0xf6 0x8>;
		reg = <0x0 0x1a0b1000 0x0 0x1000>;
	};

	charger {
		ac_charger_current = <0x1f47d0>;
		ac_charger_input_current = <0x1f47d0>;
		algorithm_name = "SwitchCharging";
		apple_1_0a_charger_current = <0x9eb10>;
		apple_2_1a_charger_current = <0xc3500>;
		battery_cv = <0x432380>;
		bif_cv_under_threshold2 = <0x43e6d0>;
		bif_threshold1 = <0x40d990>;
		bif_threshold2 = <0x419ce0>;
		cable_imp_threshold = <0x2bb>;
		charging_host_charger_current = <0xf4240>;
		chg1_ta_ac_charger_current = <0x16e360>;
		chg2_ta_ac_charger_current = <0x16e360>;
		compatible = "mediatek,charger";
		enable_min_charge_temp;
		enable_sw_jeita;
		enable_type_c;
		jeita_temp_above_t4_cv = <0x3e8fa0>;
		jeita_temp_below_t0_cv = <0x432380>;
		jeita_temp_t0_to_t1_cv = <0x432380>;
		jeita_temp_t1_to_t2_cv = <0x432380>;
		jeita_temp_t2_to_t3_cv = <0x432380>;
		jeita_temp_t3_to_t4_cv = <0x3e8fa0>;
		linux,phandle = <0x7e>;
		max_charge_temp = <0x37>;
		max_charge_temp_minus_x_degree = <0x34>;
		max_charger_voltage = <0x5a06e0>;
		min_charge_temp = <0x0>;
		min_charge_temp_plus_x_degree = <0x6>;
		min_charger_voltage = <0x432380>;
		non_std_ac_charger_current = <0xf4240>;
		pe20_ichg_level_threshold = <0xf4240>;
		pe40_dual_charger_chg1_current = <0x1e8480>;
		pe40_dual_charger_chg2_current = <0x1e8480>;
		pe40_dual_charger_input_current = <0x2dc6c0>;
		pe40_single_charger_current = <0x2dc6c0>;
		pe40_single_charger_input_current = <0x2dc6c0>;
		pe40_stop_battery_soc = <0x50>;
		pe_ichg_level_threshold = <0xf4240>;
		phandle = <0x7e>;
		power_path_support;
		ta_9v_support;
		ta_ac_7v_input_current = <0x1e8480>;
		ta_ac_9v_input_current = <0x1e8480>;
		ta_ac_charger_current = <0x1f47d0>;
		ta_start_battery_soc = <0x0>;
		ta_stop_battery_soc = <0x55>;
		temp_neg_10_thres = <0x0>;
		temp_t0_thres = <0x5>;
		temp_t0_thres_plus_x_degree = <0xa>;
		temp_t1_thres = <0xa>;
		temp_t1_thres_plus_x_degree = <0xf>;
		temp_t2_thres = <0xf>;
		temp_t2_thres_plus_x_degree = <0x15>;
		temp_t3_thres = <0x2d>;
		temp_t3_thres_minus_x_degree = <0x27>;
		temp_t4_thres = <0x37>;
		temp_t4_thres_minus_x_degree = <0x34>;
		usb_charger_current = <0x7a120>;
		usb_charger_current_configured = <0x7a120>;
		usb_charger_current_suspend = <0x0>;
		usb_charger_current_unconfigured = <0x11170>;
		vbat_cable_imp_threshold = <0x3b8260>;
	};

	chipid@08000000 {
		compatible = "mediatek,chipid";
		reg = <0x0 0x8000000 0x0 0x4 0x0 0x8000004 0x0 0x4 0x0 0x8000008 0x0 0x4 0x0 0x800000c 0x0 0x4>;
	};

	chosen {
		bootargs = "console=tty0 console=ttyS0,921600n1 root=/dev/raminitrd=0x45000000,0x200000 loglevel=8 androidboot.selinux=permissive";
		linux,phandle = <0x4b>;
		phandle = <0x4b>;
	};

	clocks {

		clk26m {
			#clock-cells = <0x0>;
			clock-frequency = <0x18cba80>;
			compatible = "fixed-clock";
			linux,phandle = <0x1f>;
			phandle = <0x1f>;
		};

		clk32k {
			#clock-cells = <0x0>;
			clock-frequency = <0x7d00>;
			compatible = "fixed-clock";
			linux,phandle = <0x1d>;
			phandle = <0x1d>;
		};
	};

	consys@18002000 {
		#address-cells = <0x2>;
		#size-cells = <0x2>;
		clock-names = "conn";
		clocks = <0x25 0x1>;
		compatible = "mediatek,mt6765-consys";
		interrupts = <0x0 0x10b 0x8 0x0 0x10d 0x8 0x0 0x10e 0x1>;
		linux,phandle = <0x1b>;
		phandle = <0x1b>;
		reg = <0x0 0x18002000 0x0 0x1000 0x0 0x10007000 0x0 0x100 0x0 0x10001000 0x0 0x1000 0x0 0x10006000 0x0 0x1000 0x0 0x18007000 0x0 0x1000 0x0 0x180b1000 0x0 0x1000 0x0 0x180a3000 0x0 0x1000 0x0 0x180a5000 0x0 0x800 0x0 0x180c1000 0x0 0x1000 0x0 0x18004000 0x0 0x1000>;
	};

	cpu_dbgapb@0d410000 {
		compatible = "mediatek,hw_dbg";
		linux,phandle = <0x4d>;
		num = <0x8>;
		phandle = <0x4d>;
		reg = <0x0 0xd410000 0x0 0x1000 0x0 0xd510000 0x0 0x1000 0x0 0xd610000 0x0 0x1000 0x0 0xd710000 0x0 0x1000 0x0 0xd810000 0x0 0x1000 0x0 0xd910000 0x0 0x1000 0x0 0xda10000 0x0 0x1000 0x0 0xdb10000 0x0 0x1000>;
	};

	cpus {
		#address-cells = <0x1>;
		#size-cells = <0x0>;

		cpu-map {

			cluster0 {

				core0 {
					cpu = <0x9>;
				};

				core1 {
					cpu = <0xa>;
				};

				core2 {
					cpu = <0xb>;
				};

				core3 {
					cpu = <0xc>;
				};
			};

			cluster1 {

				core0 {
					cpu = <0xd>;
				};

				core1 {
					cpu = <0xe>;
				};

				core2 {
					cpu = <0xf>;
				};

				core3 {
					cpu = <0x10>;
				};
			};
		};

		cpu@000 {
			clock-frequency = <0x89267940>;
			compatible = "arm,cortex-a53";
			cpu-idle-states = <0x2 0x3 0x4 0x5 0x6 0x7 0x8>;
			device_type = "cpu";
			enable-method = "psci";
			linux,phandle = <0x9>;
			phandle = <0x9>;
			reg = <0x0>;
		};

		cpu@001 {
			clock-frequency = <0x89267940>;
			compatible = "arm,cortex-a53";
			cpu-idle-states = <0x2 0x3 0x4 0x5 0x6 0x7 0x8>;
			device_type = "cpu";
			enable-method = "psci";
			linux,phandle = <0xa>;
			phandle = <0xa>;
			reg = <0x1>;
		};

		cpu@002 {
			clock-frequency = <0x89267940>;
			compatible = "arm,cortex-a53";
			cpu-idle-states = <0x2 0x3 0x4 0x5 0x6 0x7 0x8>;
			device_type = "cpu";
			enable-method = "psci";
			linux,phandle = <0xb>;
			phandle = <0xb>;
			reg = <0x2>;
		};

		cpu@003 {
			clock-frequency = <0x89267940>;
			compatible = "arm,cortex-a53";
			cpu-idle-states = <0x2 0x3 0x4 0x5 0x6 0x7 0x8>;
			device_type = "cpu";
			enable-method = "psci";
			linux,phandle = <0xc>;
			phandle = <0xc>;
			reg = <0x3>;
		};

		cpu@100 {
			clock-frequency = <0x6b49d200>;
			compatible = "arm,cortex-a53";
			cpu-idle-states = <0x2 0x3 0x4 0x5 0x6 0x7 0x8>;
			device_type = "cpu";
			enable-method = "psci";
			linux,phandle = <0xd>;
			phandle = <0xd>;
			reg = <0x100>;
		};

		cpu@101 {
			clock-frequency = <0x6b49d200>;
			compatible = "arm,cortex-a53";
			cpu-idle-states = <0x2 0x3 0x4 0x5 0x6 0x7 0x8>;
			device_type = "cpu";
			enable-method = "psci";
			linux,phandle = <0xe>;
			phandle = <0xe>;
			reg = <0x101>;
		};

		cpu@102 {
			clock-frequency = <0x6b49d200>;
			compatible = "arm,cortex-a53";
			cpu-idle-states = <0x2 0x3 0x4 0x5 0x6 0x7 0x8>;
			device_type = "cpu";
			enable-method = "psci";
			linux,phandle = <0xf>;
			phandle = <0xf>;
			reg = <0x102>;
		};

		cpu@103 {
			clock-frequency = <0x6b49d200>;
			compatible = "arm,cortex-a53";
			cpu-idle-states = <0x2 0x3 0x4 0x5 0x6 0x7 0x8>;
			device_type = "cpu";
			enable-method = "psci";
			linux,phandle = <0x10>;
			phandle = <0x10>;
			reg = <0x103>;
		};

		idle-states {
			entry-method = "arm,psci";

			dpidle {
				arm,psci-suspend-param = <0x1010004>;
				compatible = "arm,idle-state";
				entry-latency-us = <0x320>;
				exit-latency-us = <0x3e8>;
				linux,phandle = <0x7>;
				min-residency-us = <0x7d0>;
				phandle = <0x7>;
			};

			mcdi-cluster {
				arm,psci-suspend-param = <0x1010001>;
				compatible = "arm,idle-state";
				entry-latency-us = <0x258>;
				exit-latency-us = <0x258>;
				linux,phandle = <0x4>;
				min-residency-us = <0x4b0>;
				phandle = <0x4>;
			};

			mcdi-cpu {
				arm,psci-suspend-param = <0x10001>;
				compatible = "arm,idle-state";
				entry-latency-us = <0x258>;
				exit-latency-us = <0x258>;
				linux,phandle = <0x3>;
				min-residency-us = <0x4b0>;
				phandle = <0x3>;
			};

			sodi {
				arm,psci-suspend-param = <0x1010002>;
				compatible = "arm,idle-state";
				entry-latency-us = <0x320>;
				exit-latency-us = <0x3e8>;
				linux,phandle = <0x5>;
				min-residency-us = <0x7d0>;
				phandle = <0x5>;
			};

			sodi3 {
				arm,psci-suspend-param = <0x1010003>;
				compatible = "arm,idle-state";
				entry-latency-us = <0x320>;
				exit-latency-us = <0x3e8>;
				linux,phandle = <0x6>;
				min-residency-us = <0x7d0>;
				phandle = <0x6>;
			};

			standby {
				arm,psci-suspend-param = <0x1>;
				compatible = "arm,idle-state";
				entry-latency-us = <0x258>;
				exit-latency-us = <0x258>;
				linux,phandle = <0x2>;
				min-residency-us = <0x4b0>;
				phandle = <0x2>;
			};

			suspend {
				arm,psci-suspend-param = <0x1010005>;
				compatible = "arm,idle-state";
				entry-latency-us = <0x320>;
				exit-latency-us = <0x3e8>;
				linux,phandle = <0x8>;
				min-residency-us = <0x7d0>;
				phandle = <0x8>;
			};
		};
	};

	cq_dma@10212000 {
		clock-names = "cqdma";
		clocks = <0x24 0x43>;
		compatible = "mediatek,mt-cqdma-v1";
		interrupts = <0x0 0x71 0x8 0x0 0x72 0x8>;
		keep_clock_ao = "yes";
		nr_channel = <0x2>;
		reg = <0x0 0x10212000 0x0 0x80 0x0 0x10212080 0x0 0x80>;
	};

	dbg_apmcu_mp0@0d400000 {
		compatible = "mediatek,dbg_apmcu_mp0";
		reg = <0x0 0xd400000 0x0 0x1000>;
	};

	dbg_apmcu_mp0@0d410000 {
		compatible = "mediatek,dbg_apmcu_mp0";
		reg = <0x0 0xd410000 0x0 0x1000>;
	};

	dbg_apmcu_mp0@0d420000 {
		compatible = "mediatek,dbg_apmcu_mp0";
		reg = <0x0 0xd420000 0x0 0x1000>;
	};

	dbg_apmcu_mp0@0d430000 {
		compatible = "mediatek,dbg_apmcu_mp0";
		reg = <0x0 0xd430000 0x0 0x1000>;
	};

	dbg_apmcu_mp0@0d440000 {
		compatible = "mediatek,dbg_apmcu_mp0";
		reg = <0x0 0xd440000 0x0 0x1000>;
	};

	dbg_apmcu_mp0@0d510000 {
		compatible = "mediatek,dbg_apmcu_mp0";
		reg = <0x0 0xd510000 0x0 0x1000>;
	};

	dbg_apmcu_mp0@0d520000 {
		compatible = "mediatek,dbg_apmcu_mp0";
		reg = <0x0 0xd520000 0x0 0x1000>;
	};

	dbg_apmcu_mp0@0d530000 {
		compatible = "mediatek,dbg_apmcu_mp0";
		reg = <0x0 0xd530000 0x0 0x1000>;
	};

	dbg_apmcu_mp0@0d540000 {
		compatible = "mediatek,dbg_apmcu_mp0";
		reg = <0x0 0xd540000 0x0 0x1000>;
	};

	dbg_apmcu_mp0@0d610000 {
		compatible = "mediatek,dbg_apmcu_mp0";
		reg = <0x0 0xd610000 0x0 0x1000>;
	};

	dbg_apmcu_mp0@0d620000 {
		compatible = "mediatek,dbg_apmcu_mp0";
		reg = <0x0 0xd620000 0x0 0x1000>;
	};

	dbg_apmcu_mp0@0d630000 {
		compatible = "mediatek,dbg_apmcu_mp0";
		reg = <0x0 0xd630000 0x0 0x1000>;
	};

	dbg_apmcu_mp0@0d640000 {
		compatible = "mediatek,dbg_apmcu_mp0";
		reg = <0x0 0xd640000 0x0 0x1000>;
	};

	dbg_apmcu_mp0@0d710000 {
		compatible = "mediatek,dbg_apmcu_mp0";
		reg = <0x0 0xd710000 0x0 0x1000>;
	};

	dbg_apmcu_mp0@0d720000 {
		compatible = "mediatek,dbg_apmcu_mp0";
		reg = <0x0 0xd720000 0x0 0x1000>;
	};

	dbg_apmcu_mp0@0d730000 {
		compatible = "mediatek,dbg_apmcu_mp0";
		reg = <0x0 0xd730000 0x0 0x1000>;
	};

	dbg_apmcu_mp0@0d740000 {
		compatible = "mediatek,dbg_apmcu_mp0";
		reg = <0x0 0xd740000 0x0 0x1000>;
	};

	dbg_apmcu_mp1@0d800000 {
		compatible = "mediatek,dbg_apmcu_mp1";
		reg = <0x0 0xd800000 0x0 0x1000>;
	};

	dbg_apmcu_mp1@0d810000 {
		compatible = "mediatek,dbg_apmcu_mp1";
		reg = <0x0 0xd810000 0x0 0x1000>;
	};

	dbg_apmcu_mp1@0d820000 {
		compatible = "mediatek,dbg_apmcu_mp1";
		reg = <0x0 0xd820000 0x0 0x1000>;
	};

	dbg_apmcu_mp1@0d830000 {
		compatible = "mediatek,dbg_apmcu_mp1";
		reg = <0x0 0xd830000 0x0 0x1000>;
	};

	dbg_apmcu_mp1@0d840000 {
		compatible = "mediatek,dbg_apmcu_mp1";
		reg = <0x0 0xd840000 0x0 0x1000>;
	};

	dbg_apmcu_mp1@0d910000 {
		compatible = "mediatek,dbg_apmcu_mp1";
		reg = <0x0 0xd910000 0x0 0x1000>;
	};

	dbg_apmcu_mp1@0d920000 {
		compatible = "mediatek,dbg_apmcu_mp1";
		reg = <0x0 0xd920000 0x0 0x1000>;
	};

	dbg_apmcu_mp1@0d930000 {
		compatible = "mediatek,dbg_apmcu_mp1";
		reg = <0x0 0xd930000 0x0 0x1000>;
	};

	dbg_apmcu_mp1@0d940000 {
		compatible = "mediatek,dbg_apmcu_mp1";
		reg = <0x0 0xd940000 0x0 0x1000>;
	};

	dbg_apmcu_mp1@0da10000 {
		compatible = "mediatek,dbg_apmcu_mp1";
		reg = <0x0 0xda10000 0x0 0x1000>;
	};

	dbg_apmcu_mp1@0da20000 {
		compatible = "mediatek,dbg_apmcu_mp1";
		reg = <0x0 0xda20000 0x0 0x1000>;
	};

	dbg_apmcu_mp1@0da30000 {
		compatible = "mediatek,dbg_apmcu_mp1";
		reg = <0x0 0xda30000 0x0 0x1000>;
	};

	dbg_apmcu_mp1@0da40000 {
		compatible = "mediatek,dbg_apmcu_mp1";
		reg = <0x0 0xda40000 0x0 0x1000>;
	};

	dbg_apmcu_mp1@0db10000 {
		compatible = "mediatek,dbg_apmcu_mp1";
		reg = <0x0 0xdb10000 0x0 0x1000>;
	};

	dbg_apmcu_mp1@0db20000 {
		compatible = "mediatek,dbg_apmcu_mp1";
		reg = <0x0 0xdb20000 0x0 0x1000>;
	};

	dbg_apmcu_mp1@0db30000 {
		compatible = "mediatek,dbg_apmcu_mp1";
		reg = <0x0 0xdb30000 0x0 0x1000>;
	};

	dbg_apmcu_mp1@0db40000 {
		compatible = "mediatek,dbg_apmcu_mp1";
		reg = <0x0 0xdb40000 0x0 0x1000>;
	};

	dbg_cti@0d020000 {
		compatible = "mediatek,dbg_cti";
		reg = <0x0 0xd020000 0x0 0x10000>;
	};

	dbg_dem@0d0a0000 {
		compatible = "mediatek,dbg_dem";
		interrupts = <0x0 0x8c 0x8>;
		reg = <0x0 0xd0a0000 0x0 0x10000>;
	};

	dbg_etr@0d030000 {
		compatible = "mediatek,dbg_etr";
		reg = <0x0 0xd030000 0x0 0x10000>;
	};

	dbg_funnel@0d040000 {
		compatible = "mediatek,dbg_funnel";
		reg = <0x0 0xd040000 0x0 0x10000>;
	};

	dbg_mdsys1@0d0c0000 {
		compatible = "mediatek,dbg_mdsys1";
		reg = <0x0 0xd0c0000 0x0 0x40000>;
	};

	ddrphy@10015000 {
		compatible = "mediatek,ddrphy";
		reg = <0x0 0x10015000 0x0 0x1000>;
	};

	ddrphy@1001e000 {
		compatible = "mediatek,ddrphy";
		reg = <0x0 0x1001e000 0x0 0x1000>;
	};

	devapc@10207000 {
		clock-names = "devapc-infra-clock";
		clocks = <0x24 0x28>;
		compatible = "mediatek,devapc";
		interrupts = <0x0 0x8e 0x8>;
		reg = <0x0 0x10207000 0x0 0x1000>;
	};

	dfd@10200b00 {
		compatible = "mediatek,dfd";
		mediatek,chain_length = <0xc350>;
		mediatek,enabled = <0x1>;
		mediatek,rg_dfd_timeout = <0xa0>;
		reg = <0x0 0x10200b00 0x0 0x10000>;
	};

	dip1@15022000 {
		compatible = "mediatek,dip1";
		interrupts = <0x0 0xff 0x8>;
		reg = <0x0 0x15022000 0x0 0x3000>;
	};

	disp_aal0@14011000 {
		compatible = "mediatek,disp_aal0";
		interrupts = <0x0 0xde 0x8>;
		reg = <0x0 0x14011000 0x0 0x1000>;
	};

	disp_ccorr0@14010000 {
		compatible = "mediatek,disp_ccorr0";
		interrupts = <0x0 0xdd 0x8>;
		reg = <0x0 0x14010000 0x0 0x1000>;
	};

	disp_color0@1400f000 {
		clock-names = "MDP_COLOR";
		clocks = <0x26 0xc>;
		compatible = "mediatek,disp_color0";
		interrupts = <0x0 0xdc 0x8>;
		linux,phandle = <0x2d>;
		phandle = <0x2d>;
		reg = <0x0 0x1400f000 0x0 0x1000>;
	};

	disp_dither0@14013000 {
		compatible = "mediatek,disp_dither0";
		interrupts = <0x0 0xe0 0x8>;
		reg = <0x0 0x14013000 0x0 0x1000>;
	};

	disp_gamma0@14012000 {
		compatible = "mediatek,disp_gamma0";
		interrupts = <0x0 0xdf 0x8>;
		reg = <0x0 0x14012000 0x0 0x1000>;
	};

	disp_mutex0@14001000 {
		compatible = "mediatek,disp_mutex0";
		interrupts = <0x0 0xd2 0x8>;
		linux,phandle = <0x2f>;
		phandle = <0x2f>;
		reg = <0x0 0x14001000 0x0 0x1000>;
	};

	disp_ovl0@1400b000 {
		compatible = "mediatek,disp_ovl0";
		interrupts = <0x0 0xd9 0x8>;
		reg = <0x0 0x1400b000 0x0 0x1000>;
	};

	disp_ovl0_2l@1400c000 {
		compatible = "mediatek,disp_ovl0_2l";
		interrupts = <0x0 0xe5 0x8>;
		reg = <0x0 0x1400c000 0x0 0x1000>;
	};

	disp_pwm@1100e000 {
		compatible = "mediatek,disp_pwm";
		reg = <0x0 0x1100e000 0x0 0x1000>;
	};

	disp_rdma0@1400d000 {
		compatible = "mediatek,disp_rdma0";
		interrupts = <0x0 0xda 0x8>;
		reg = <0x0 0x1400d000 0x0 0x1000>;
	};

	disp_rsz0@14015000 {
		compatible = "mediatek,disp_rsz0";
		interrupts = <0x0 0x114 0x8>;
		reg = <0x0 0x14015000 0x0 0x1000>;
	};

	disp_wdma0@1400e000 {
		compatible = "mediatek,disp_wdma0";
		interrupts = <0x0 0xdb 0x8>;
		reg = <0x0 0x1400e000 0x0 0x1000>;
	};

	dispsys {
		clock-names = "MMSYS_MTCMOS", "MMSYS_SMI_COMMON", "MMSYS_SMI_LARB0", "MMSYS_GALS_COMM0", "MMSYS_GALS_COMM1", "MMSYS_DISP_OVL0", "MMSYS_DISP_OVL0_2L", "MMSYS_DISP_RDMA0", "MMSYS_DISP_WDMA0", "MMSYS_DISP_COLOR0", "MMSYS_DISP_CCORR0", "MMSYS_DISP_AAL0", "MMSYS_DISP_GAMMA0", "MMSYS_DISP_DITHER0", "MMSYS_DSI0_MM_CK", "MMSYS_DSI0_IF_CK", "MMSYS_26M", "MMSYS_DISP_RSZ0", "APMIXED_MIPI_26M", "TOP_MUX_DISP_PWM", "DISP_PWM", "TOP_26M", "TOP_UNIVPLL2_D4", "TOP_ULPOSC1_D2", "TOP_ULPOSC1_D8";
		clocks = <0x25 0x3 0x26 0x13 0x26 0x14 0x26 0x15 0x26 0x16 0x26 0x7 0x26 0x8 0x26 0xa 0x26 0xb 0x26 0xc 0x26 0xd 0x26 0xe 0x26 0xf 0x26 0x10 0x26 0x11 0x26 0x1c 0x26 0x1d 0x26 0x9 0x40 0x15 0x1e 0x60 0x24 0x31 0x1f 0x1e 0x1a 0x1e 0x2d 0x1e 0x2f>;
		compatible = "mediatek,dispsys";
		mediatek,larb = <0x20>;
	};

	dma-controller@11000580 {
		#dma-cells = <0x1>;
		clock-names = "apdma";
		clocks = <0x24 0x26>;
		compatible = "mediatek,mt6577-uart-dma";
		interrupts = <0x0 0x6d 0x8 0x0 0x6e 0x8 0x0 0x6f 0x8 0x0 0x74 0x8>;
		linux,phandle = <0x31>;
		phandle = <0x31>;
		reg = <0x0 0x11000680 0x0 0x80 0x0 0x11000700 0x0 0x80 0x0 0x11000780 0x0 0x80 0x0 0x11000800 0x0 0x80>;
	};

	dpe@15028000 {
		clock-names = "DPE_CG_IMG_DPE";
		clocks = <0x41 0x3>;
		compatible = "mediatek,dpe";
		interrupts = <0x0 0x100 0x8>;
		reg = <0x0 0x15028000 0x0 0x1000>;
	};

	dramc0@1001d000 {
		compatible = "mediatek,dramc0";
		reg = <0x0 0x1001d000 0x0 0x1000>;
	};

	dramc@1022a000 {
		compatible = "mediatek,dramc";
		reg = <0x0 0x1022a000 0x0 0x2000 0x0 0x10232000 0x0 0x2000 0x0 0x1022c000 0x0 0x1000 0x0 0x10234000 0x0 0x1000 0x0 0x10228000 0x0 0x2000 0x0 0x10230000 0x0 0x2000 0x0 0x1022e000 0x0 0x1000 0x0 0x10236000 0x0 0x1000>;
	};

	dramc_nao@1021d000 {
		compatible = "mediatek,dramc_nao";
		reg = <0x0 0x1021d000 0x0 0x1000>;
	};

	dsi0@14014000 {
		compatible = "mediatek,dsi0";
		interrupts = <0x0 0xe1 0x8>;
		reg = <0x0 0x14014000 0x0 0x1000>;
	};

	dsi_te {
		compatible = "mediatek, DSI_TE-eint";
		linux,phandle = <0x78>;
		phandle = <0x78>;
		status = "disabled";
	};

	dvfsp@00110800 {
		compatible = "mediatek,mt6765-dvfsp";
		reg = <0x0 0x110800 0x0 0x1400 0x0 0x110800 0x0 0x1400>;
	};

	dvfsp@10227000 {
		compatible = "mediatek,dvfsp";
		reg = <0x0 0x10227000 0x0 0x1000>;
	};

	dvfsrc@10012000 {
		compatible = "mediatek,dvfsrc";
		reg = <0x0 0x10012000 0x0 0x1000 0x0 0x110780 0x0 0x80>;
	};

	dxcc_sec@10210000 {
		compatible = "mediatek,dxcc_sec";
		interrupts = <0x0 0xa2 0x4>;
		reg = <0x0 0x10210000 0x0 0x1000>;
	};

	eas {
		eff_turn_point = <0x1d3>;
		tiny = <0x32>;
	};

	eem_fsm@1100b000 {
		compatible = "mediatek,eem_fsm";
		interrupts = <0x0 0x7d 0x8>;
		reg = <0x0 0x1100b000 0x0 0x1000>;
	};

	efuse_dbg@10004000 {
		compatible = "mediatek,efuse_dbg";
		reg = <0x0 0x10004000 0x0 0x1000>;
	};

	efusec@11c50000 {
		compatible = "mediatek,efusec";
		reg = <0x0 0x11c50000 0x0 0x10000>;
	};

	emi@10219000 {
		compatible = "mediatek,emi";
		interrupts = <0x0 0x90 0x8>;
		reg = <0x0 0x10219000 0x0 0x1000 0x0 0x10226000 0x0 0x1000 0x0 0x1022d000 0x0 0x1000 0x0 0x10235000 0x0 0x1000>;
	};

	fdvt@1502b000 {
		clock-names = "FD_CLK_IMG_FDVT";
		clocks = <0x41 0x2>;
		compatible = "mediatek,fdvt";
		interrupts = <0x0 0x102 0x8>;
		reg = <0x0 0x1502b000 0x0 0x1000>;
	};

	fhctl@1000ce00 {
		compatible = "mediatek,fhctl";
		reg = <0x0 0x1000ce00 0x0 0x200>;
	};

	fingerprint {
		compatible = "mediatek,fpc1022_irq", "mediatek,goodix-fp";
		linux,phandle = <0x59>;
		phandle = <0x59>;
	};

	firmware {

		android {
			compatible = "android,firmware";

			fstab {
				compatible = "android,fstab";

				system {
					compatible = "android,system";
					dev = "/dev/block/platform/bootdevice/by-name/system";
					fsmgr_flags = "wait,avb";
					mnt_flags = "ro";
					type = "ext4";
				};

				vendor {
					compatible = "android,vendor";
					dev = "/dev/block/platform/bootdevice/by-name/vendor";
					fsmgr_flags = "wait,avb";
					mnt_flags = "ro";
					type = "ext4";
				};
			};

			vbmeta {
				compatible = "android,vbmeta";
				parts = "vbmeta,boot,system,vendor";
			};
		};
	};

	flashlight_core {
		compatible = "mediatek,flashlight_core";
		linux,phandle = <0x7a>;
		phandle = <0x7a>;
	};

	flashlights_mt6370 {
		compatible = "mediatek,flashlights_mt6370";
		decouple = <0x1>;
		linux,phandle = <0x7b>;
		phandle = <0x7b>;

		channel@1 {
			ct = <0x0>;
			part = <0x0>;
			type = <0x0>;
		};
	};

	gauge_timer {
		compatible = "mediatek,gauge_timer_service";
	};

	gce@10238000 {
		#clock-cells = <0x1>;
		ap_dma_base = <0x18010000 0x17 0xffff0000>;
		audio_base = <0x17000000 0x12 0xffff0000>;
		buf_underrun_event_0 = <0x8c>;
		camsys1_base = <0x180a0000 0x1c 0xffff0000>;
		camsys2_base = <0x180b0000 0x1d 0xffff0000>;
		camsys_base = <0x18080000 0x1b 0xffff0000>;
		clock-names = "GCE", "GCE_TIMER";
		clocks = <0x24 0x9 0x24 0x18>;
		compatible = "mediatek,gce", "syscon";
		conn_peri_base = <0x18820000 0x7 0xffff0000>;
		dip_cq_thread0_frame_done = <0x101>;
		dip_cq_thread10_frame_done = <0x10b>;
		dip_cq_thread11_frame_done = <0x10c>;
		dip_cq_thread12_frame_done = <0x10d>;
		dip_cq_thread13_frame_done = <0x10e>;
		dip_cq_thread14_frame_done = <0x10f>;
		dip_cq_thread15_frame_done = <0x110>;
		dip_cq_thread16_frame_done = <0x111>;
		dip_cq_thread17_frame_done = <0x112>;
		dip_cq_thread18_frame_done = <0x113>;
		dip_cq_thread1_frame_done = <0x102>;
		dip_cq_thread2_frame_done = <0x103>;
		dip_cq_thread3_frame_done = <0x104>;
		dip_cq_thread4_frame_done = <0x105>;
		dip_cq_thread5_frame_done = <0x106>;
		dip_cq_thread6_frame_done = <0x107>;
		dip_cq_thread7_frame_done = <0x108>;
		dip_cq_thread8_frame_done = <0x109>;
		dip_cq_thread9_frame_done = <0x10a>;
		disp_2l_ovl0_frame_done = <0x1c>;
		disp_2l_ovl0_sof = <0x8>;
		disp_aal0_frame_done = <0x22>;
		disp_aal0_sof = <0xd>;
		disp_ccorr0_frame_done = <0x21>;
		disp_ccorr0_sof = <0xc>;
		disp_color0_frame_done = <0x20>;
		disp_color0_sof = <0xb>;
		disp_dither0_frame_done = <0x24>;
		disp_dither0_sof = <0xf>;
		disp_dither_base = <0x14010000 0x2 0xffff0000>;
		disp_dsi0_frame_done = <0x25>;
		disp_dsi0_sof = <0x10>;
		disp_gamma0_frame_done = <0x23>;
		disp_gamma0_sof = <0xe>;
		disp_ovl0_frame_done = <0x1b>;
		disp_ovl0_frame_rst_done_pusle = <0x98>;
		disp_ovl0_sof = <0x7>;
		disp_pwm0_sof = <0x13>;
		disp_rdma0_frame_done = <0x1e>;
		disp_rdma0_sof = <0x9>;
		disp_rsz0_frame_done = <0x1d>;
		disp_rsz0_sof = <0x11>;
		disp_wdma0_frame_done = <0x1f>;
		disp_wdma0_rst_done = <0x93>;
		disp_wdma0_sof = <0xa>;
		dsi0_done_event = <0x8f>;
		dsi0_irq_event = <0x8e>;
		dsi0_te_event = <0x8d>;
		dve_frame_done = <0x114>;
		g3d_config_base = <0x13000000 0x0 0xffff0000>;
		gce_base = <0x18020000 0x18 0xffff0000>;
		gcpu_base = <0x10050000 0xf 0xffff0000>;
		img_dl_relay_sof = <0x12>;
		imgsys_base = <0x15020000 0x4 0xffff0000>;
		infra_na3_base = <0x10010000 0xb 0xffff0000>;
		infra_na4_base = <0x10020000 0xc 0xffff0000>;
		interrupts = <0x0 0x9a 0x8 0x0 0x9b 0x8>;
		jpgdec_done = <0x123>;
		jpgenc_done = <0x122>;
		kp_base = <0x18840000 0x9 0xffff0000>;
		linux,phandle = <0x5b>;
		max_prefetch_cnt = <0x1>;
		mboxes = <0x30 0x0 0x0 0x30 0x1 0x0 0x30 0x2 0x0 0x30 0x3 0x0 0x30 0x4 0x0 0x30 0x5 0x0 0x30 0x6 0x0 0x30 0x7 0x0 0x30 0x8 0x0 0x30 0x9 0x0 0x30 0xa 0x0 0x30 0xb 0x0 0x30 0xc 0x0 0x30 0xd 0x0 0x30 0xe 0x0 0x30 0xf 0x0>;
		mcucfg_base = <0x10040000 0xe 0xffff0000>;
		mdp_ccorr0 = <0x2e>;
		mdp_ccorr0_frame_done = <0x15>;
		mdp_ccorr0_sof = <0x1>;
		mdp_color0 = <0x2d>;
		mdp_rdma0 = <0x27>;
		mdp_rdma0_frame_done = <0x14>;
		mdp_rdma0_rst_done = <0x97>;
		mdp_rdma0_sof = <0x0>;
		mdp_rsz0 = <0x28>;
		mdp_rsz0_frame_done = <0x16>;
		mdp_rsz0_sof = <0x2>;
		mdp_rsz1 = <0x29>;
		mdp_rsz1_frame_done = <0x17>;
		mdp_rsz1_sof = <0x3>;
		mdp_tdshp0 = <0x2c>;
		mdp_tdshp0_frame_done = <0x1a>;
		mdp_tdshp0_sof = <0x6>;
		mdp_wdma0 = <0x2a>;
		mdp_wdma_frame_done = <0x19>;
		mdp_wdma_rst_done = <0x94>;
		mdp_wdma_sof = <0x4>;
		mdp_wrot0 = <0x2b>;
		mdp_wrot0_rst_done = <0x95>;
		mdp_wrot0_sof = <0x5>;
		mdp_wrot0_write_frame_done = <0x18>;
		mediatek,mailbox-gce = <0x30>;
		mm_mutex = <0x2f>;
		mm_na_base = <0x14020000 0x3 0xffff0000>;
		mmsys_config = <0x26>;
		mmsys_config_base = <0x14000000 0x1 0xffff0000>;
		msdc2_base = <0x17020000 0x14 0xffff0000>;
		msdc3_base = <0x18000000 0x16 0xffff0000>;
		phandle = <0x5b>;
		prefetch_size = <0x60>;
		pwm_sw_base = <0x1100e000 0x63 0xffff0000>;
		reg = <0x0 0x10238000 0x0 0x4000>;
		rsc_frame_done = <0x116>;
		scp_base = <0x10030000 0xd 0xffff0000>;
		scp_sram_base = <0x10000000 0xa 0xffff0000>;
		sram_share_cnt = <0x1>;
		sram_share_engine = <0xa>;
		sram_share_event = <0x1e0>;
		sram_size_cpr_64 = <0x40>;
		stream_done_0 = <0x82>;
		stream_done_1 = <0x83>;
		stream_done_2 = <0x84>;
		stream_done_3 = <0x85>;
		stream_done_4 = <0x86>;
		stream_done_5 = <0x87>;
		stream_done_6 = <0x88>;
		stream_done_7 = <0x89>;
		stream_done_8 = <0x8a>;
		stream_done_9 = <0x8b>;
		topckgen_base = <0x18830000 0x8 0xffff0000>;
		usb0_base = <0x10200000 0x10 0xffff0000>;
		usb_sif_base = <0x10280000 0x11 0xffff0000>;
		vdec1_base = <0x17030000 0x15 0xffff0000>;
		vdec2_base = <0x18040000 0x19 0xffff0000>;
		vdec3_base = <0x18050000 0x1a 0xffff0000>;
		vdec_base = <0x17010000 0x13 0xffff0000>;
		vdec_gcon_base = <0x18800000 0x5 0xffff0000>;
		venc_128byte_cnt_done = <0x125>;
		venc_done = <0x121>;
		venc_gcon_base = <0x18810000 0x6 0xffff0000>;
		venc_mb_done = <0x124>;
		wmf_frame_done = <0x115>;
	};

	gce_mbox@10238000 {
		#mbox-cells = <0x2>;
		clock-names = "gce", "GCE_TIMER";
		clocks = <0x24 0x9 0x24 0x18>;
		compatible = "mediatek,mailbox-gce";
		interrupts = <0x0 0x9a 0x8 0x0 0x9b 0x8>;
		linux,phandle = <0x30>;
		phandle = <0x30>;
		reg = <0x0 0x10238000 0x0 0x4000>;
	};

	gic500@0c000000 {
		compatible = "mediatek,gic500";
		reg = <0x0 0xc000000 0x0 0x1000>;
	};

	gic_cpu@0c400000 {
		compatible = "mediatek,gic_cpu";
		reg = <0x0 0xc400000 0x0 0x40000>;
	};

	gpio {
		compatible = "mediatek,gpio_usage_mapping";
		linux,phandle = <0x4f>;
		phandle = <0x4f>;
	};

	gpio@10005000 {
		compatible = "mediatek,gpio";
		linux,phandle = <0x50>;
		phandle = <0x50>;
		reg = <0x0 0x10005000 0x0 0x1000>;
	};

	gps {
		compatible = "mediatek,gps";
	};

	gpufreq {
		clock-names = "clk_mux", "clk_main_parent", "clk_sub_parent", "mtcmos_mfg_async", "mtcmos_mfg", "mtcmos_mfg_core0";
		clocks = <0x1e 0x51 0x1e 0x25 0x1f 0x25 0x8 0x25 0x4 0x25 0x7>;
		compatible = "mediatek,mt6765-gpufreq";
	};

	hacc@1000a000 {
		compatible = "mediatek,hacc";
		interrupts = <0x0 0xbd 0x8>;
		reg = <0x0 0x1000a000 0x0 0x1000>;
	};

	i2c0@11007000 {
		aed = <0x1a>;
		clock-div = <0x5>;
		clock-names = "main", "dma";
		clocks = <0x24 0xb 0x24 0x26>;
		compatible = "mediatek,i2c";
		id = <0x0>;
		interrupts = <0x0 0x54 0x8>;
		linux,phandle = <0x60>;
		mediatek,hs_only;
		phandle = <0x60>;
		reg = <0x0 0x11007000 0x0 0x1000 0x0 0x11000080 0x0 0x80>;
	};

	i2c1@11008000 {
		aed = <0x1a>;
		clock-div = <0x5>;
		clock-names = "main", "dma";
		clocks = <0x24 0xb 0x24 0x26>;
		compatible = "mediatek,i2c";
		id = <0x1>;
		interrupts = <0x0 0x55 0x8>;
		linux,phandle = <0x61>;
		mediatek,hs_only;
		phandle = <0x61>;
		reg = <0x0 0x11008000 0x0 0x1000 0x0 0x11000100 0x0 0x80>;
	};

	i2c2@11009000 {
		aed = <0x1a>;
		ch_offset_ccu = <0x200>;
		ch_offset_default = <0x100>;
		clock-div = <0x5>;
		clock-names = "main", "dma";
		clocks = <0x24 0xb 0x24 0x26>;
		compatible = "mediatek,i2c";
		id = <0x2>;
		interrupts = <0x0 0x56 0x8>;
		linux,phandle = <0x62>;
		mediatek,hs_only;
		phandle = <0x62>;
		reg = <0x0 0x11009000 0x0 0x1000 0x0 0x11000180 0x0 0x180>;
	};

	i2c3@1100f000 {
		aed = <0x1a>;
		ch_offset_default = <0x100>;
		clock-div = <0x5>;
		clock-names = "main", "dma";
		clocks = <0x24 0xb 0x24 0x26>;
		compatible = "mediatek,i2c";
		id = <0x3>;
		interrupts = <0x0 0x57 0x8>;
		linux,phandle = <0x63>;
		mediatek,hs_only;
		phandle = <0x63>;
		reg = <0x0 0x1100f000 0x0 0x1000 0x0 0x11000300 0x0 0x100>;
	};

	i2c4@11011000 {
		aed = <0x1a>;
		ch_offset_ccu = <0x200>;
		ch_offset_default = <0x100>;
		clock-div = <0x5>;
		clock-names = "main", "dma";
		clocks = <0x24 0xb 0x24 0x26>;
		compatible = "mediatek,i2c";
		id = <0x4>;
		interrupts = <0x0 0x58 0x8>;
		linux,phandle = <0x64>;
		mediatek,hs_only;
		phandle = <0x64>;
		reg = <0x0 0x11011000 0x0 0x1000 0x0 0x11000400 0x0 0x180>;
	};

	i2c5@11016000 {
		aed = <0x1a>;
		clock-div = <0x5>;
		clock-names = "main", "dma";
		clocks = <0x24 0xb 0x24 0x26>;
		compatible = "mediatek,i2c";
		id = <0x5>;
		interrupts = <0x0 0x82 0x8>;
		linux,phandle = <0x65>;
		mediatek,hs_only;
		phandle = <0x65>;
		reg = <0x0 0x11016000 0x0 0x1000 0x0 0x11000580 0x0 0x80>;
	};

	i2c6@1100d000 {
		aed = <0x1a>;
		ch_offset_ccu = <0x200>;
		ch_offset_default = <0x100>;
		clock-div = <0x5>;
		clock-names = "main", "dma";
		clocks = <0x24 0xb 0x24 0x26>;
		compatible = "mediatek,i2c";
		id = <0x6>;
		interrupts = <0x0 0x83 0x8>;
		linux,phandle = <0x66>;
		mediatek,hs_only;
		phandle = <0x66>;
		reg = <0x0 0x1100d000 0x0 0x1000 0x0 0x11000600 0x0 0x80>;
	};

	i2c7 {
		linux,phandle = <0x85>;
		phandle = <0x85>;
	};

	i2c8 {
		linux,phandle = <0x86>;
		phandle = <0x86>;
	};

	i2c9 {
		linux,phandle = <0x87>;
		phandle = <0x87>;
	};

	i2c_common {
		check_max_freq = [01];
		cnt_constraint = [01];
		compatible = "mediatek,i2c_common";
		dma_support = [02];
		ext_time_config = [18 01];
		idvfs = [01];
		linux,phandle = <0x5f>;
		phandle = <0x5f>;
		set_dt_div = [01];
		set_ltiming = [01];
		ver = [02];
	};

	imgsys@15020000 {
		#clock-cells = <0x1>;
		clock-names = "ISP_SCP_SYS_DIS", "ISP_SCP_SYS_ISP", "ISP_SCP_SYS_CAM", "ISP_CLK_IMG_DIP", "ISP_CLK_CAM", "ISP_CLK_CAMTG", "ISP_CLK_CAM_SENINF", "ISP_CLK_CAMSV0", "ISP_CLK_CAMSV1", "ISP_CLK_CAMSV2";
		clocks = <0x25 0x3 0x25 0x5 0x25 0x9 0x41 0x1 0x42 0x2 0x42 0x3 0x42 0x4 0x42 0x5 0x42 0x6 0x42 0x7>;
		compatible = "mediatek,imgsys", "syscon";
		linux,phandle = <0x41>;
		phandle = <0x41>;
		reg = <0x0 0x15020000 0x0 0x1000>;
	};

	imp_iic@11017000 {
		compatible = "mediatek,imp_iic";
		reg = <0x0 0x11017000 0x0 0x1000>;
	};

	infra_mbist@1020d000 {
		compatible = "mediatek,infra_mbist";
		reg = <0x0 0x1020d000 0x0 0x1000>;
	};

	infracfg@1020e000 {
		compatible = "mediatek,infracfg";
		reg = <0x0 0x1020e000 0x0 0x1000>;
	};

	infracfg_ao@10001000 {
		#clock-cells = <0x1>;
		compatible = "mediatek,infracfg_ao", "syscon";
		interrupts = <0x0 0x93 0x1>;
		linux,phandle = <0x24>;
		phandle = <0x24>;
		reg = <0x0 0x10001000 0x0 0x1000>;
	};

	interrupt-controller@0c000000 {
		#address-cells = <0x2>;
		#interrupt-cells = <0x3>;
		#redistributor-regions = <0x1>;
		#size-cells = <0x2>;
		compatible = "arm,gic-v3";
		interrupt-controller;
		interrupt-parent = <0x11>;
		interrupts = <0x1 0x9 0x4>;
		linux,phandle = <0x11>;
		phandle = <0x11>;
		reg = <0x0 0xc000000 0x0 0x40000 0x0 0xc100000 0x0 0x200000 0x0 0x10200a80 0x0 0x50>;
	};

	intpol-controller@10200a80 {
		#interrupt-cells = <0x3>;
		compatible = "mediatek,mt6577-sysirq";
		interrupt-controller;
		interrupt-parent = <0x11>;
		linux,phandle = <0x1>;
		phandle = <0x1>;
		reg = <0x0 0x10200a80 0x0 0x50>;
	};

	io_cfg_bl@10002600 {
		compatible = "mediatek,io_cfg_bl";
		reg = <0x0 0x10002600 0x0 0x200>;
	};

	io_cfg_lb@10002400 {
		compatible = "mediatek,io_cfg_lb";
		reg = <0x0 0x10002400 0x0 0x200>;
	};

	io_cfg_lm@10002200 {
		compatible = "mediatek,io_cfg_lm";
		reg = <0x0 0x10002200 0x0 0x200>;
	};

	io_cfg_lt@10002000 {
		compatible = "mediatek,io_cfg_lt";
		reg = <0x0 0x10002000 0x0 0x200>;
	};

	io_cfg_rb@10002a00 {
		compatible = "mediatek,io_cfg_rb";
		reg = <0x0 0x10002a00 0x0 0x200>;
	};

	io_cfg_rr@10002800 {
		compatible = "mediatek,io_cfg_rr";
		reg = <0x0 0x10002800 0x0 0x200>;
	};

	io_cfg_rt@10002c00 {
		compatible = "mediatek,io_cfg_rt";
		reg = <0x0 0x10002c00 0x0 0x200>;
	};

	iocfg_0@10002000 {
		compatible = "mediatek,iocfg_0";
		reg = <0x0 0x10002000 0x0 0x200>;
	};

	iocfg_1@10002200 {
		compatible = "mediatek,iocfg_1";
		reg = <0x0 0x10002200 0x0 0x200>;
	};

	iocfg_2@10002400 {
		compatible = "mediatek,iocfg_2";
		reg = <0x0 0x10002400 0x0 0x200>;
	};

	iocfg_3@10002600 {
		compatible = "mediatek,iocfg_3";
		reg = <0x0 0x10002600 0x0 0x200>;
	};

	iocfg_4@10002800 {
		compatible = "mediatek,iocfg_4";
		reg = <0x0 0x10002800 0x0 0x200>;
	};

	iocfg_5@10002a00 {
		compatible = "mediatek,iocfg_5";
		reg = <0x0 0x10002a00 0x0 0x200>;
	};

	irq_nfc {
		compatible = "mediatek,irq_nfc-eint";
		linux,phandle = <0x76>;
		phandle = <0x76>;
	};

	irtx_pwm {
		compatible = "mediatek,irtx-pwm";
		linux,phandle = <0x82>;
		phandle = <0x82>;
		pwm_ch = <0x0>;
		pwm_data_invert = <0x0>;
	};

	kd_camera_hw1@1a040000 {
		clock-names = "CLK_TOP_CAMTG_SEL", "CLK_TOP_CAMTG1_SEL", "CLK_TOP_CAMTG2_SEL", "CLK_TOP_CAMTG3_SEL", "CLK_MCLK_6M", "CLK_MCLK_12M", "CLK_MCLK_13M", "CLK_MCLK_48M", "CLK_MCLK_52M", "CLK_MCLK_24M", "CLK_MCLK_26M", "CLK_CAM_SENINF_CG", "CLK_MIPI_C0_26M_CG", "CLK_MIPI_C1_26M_CG", "CLK_MIPI_ANA_0A_CG", "CLK_MIPI_ANA_0B_CG", "CLK_MIPI_ANA_1A_CG", "CLK_MIPI_ANA_1B_CG", "CLK_MIPI_ANA_2A_CG", "CLK_MIPI_ANA_2B_CG", "CLK_TOP_CAMTM_SEL_CG", "CLK_TOP_CAMTM_208_CG", "CLK_SCP_SYS_CAM";
		clocks = <0x1e 0x53 0x1e 0x54 0x1e 0x55 0x1e 0x56 0x1e 0x14 0x1e 0x13 0x1e 0x1c 0x1e 0x11 0x1e 0x1b 0x1e 0x12 0x1f 0x42 0x4 0x40 0xe 0x40 0x12 0x44 0x0 0x45 0x0 0x46 0x0 0x47 0x0 0x48 0x0 0x49 0x0 0x1e 0x6a 0x1e 0x19 0x25 0x9>;
		compatible = "mediatek,camera_hw";
		linux,phandle = <0x79>;
		phandle = <0x79>;
		reg = <0x0 0x1a040000 0x0 0x1000>;
	};

	kp@10010000 {
		compatible = "mediatek,kp";
		interrupts = <0x0 0xb4 0x2>;
		linux,phandle = <0x1a>;
		phandle = <0x1a>;
		reg = <0x0 0x10010000 0x0 0x1000>;
	};

	l2c_parity {
		compatible = "mediatek,l2c_parity-v1";
		interrupts = <0x0 0x18 0x4 0x0 0x19 0x4>;
	};

	lk_charger {
		ac_charger_current = <0x1f47d0>;
		ac_charger_input_current = <0x1f47d0>;
		charging_host_charger_current = <0xf4240>;
		compatible = "mediatek,lk_charger";
		enable_anime;
		enable_pe_plus;
		fast_charge_voltage = <0x2dc6c0>;
		linux,phandle = <0x7d>;
		max_charger_voltage = <0x5a06e0>;
		non_std_ac_charger_current = <0xf4240>;
		pd_charger_current = <0x7a120>;
		phandle = <0x7d>;
		power_path_support;
		ta_ac_charger_current = <0x1f47d0>;
		temp_t1_threshold = <0x0>;
		temp_t3_threshold = <0x2d>;
		temp_t4_threshold = <0x32>;
		usb_charger_current = <0x7a120>;
	};

	m4u@10205000 {
		#iommu-cells = <0x1>;
		cell-index = <0x0>;
		compatible = "mediatek,iommu_v0";
		interrupts = <0x0 0x9e 0x8>;
		linux,phandle = <0x4a>;
		mediatek,larbs = <0x20 0x21 0x22 0x23>;
		phandle = <0x4a>;
		reg = <0x0 0x10205000 0x0 0x1000>;
	};

	mbist@17050000 {
		compatible = "mediatek,mbist";
		reg = <0x0 0x17050000 0x0 0x10000>;
	};

	mbist_ao@10013000 {
		compatible = "mediatek,mbist_ao";
		reg = <0x0 0x10013000 0x0 0x1000>;
	};

	mcdi@0010fc00 {
		compatible = "mediatek,mt6765-mcdi";
		reg = <0x0 0x10fc00 0x0 0x800>;
	};

	mcucfg@10200000 {
		compatible = "mediatek,mcucfg";
		interrupts = <0x0 0x0 0x8>;
		reg = <0x0 0x10200000 0x0 0x1000>;
	};

	mcucfg_mp0_counter@10200000 {
		compatible = "mediatek,mcucfg_mp0_counter";
		reg = <0x0 0x10200000 0x0 0x4000>;
	};

	mcupm_reg@10216000 {
		compatible = "mediatek,mcupm_reg";
		reg = <0x0 0x10216000 0x0 0x1000>;
	};

	mcupm_sram0@10217000 {
		compatible = "mediatek,mcupm_sram0";
		reg = <0x0 0x10217000 0x0 0x1000>;
	};

	mcupm_sram1@10218000 {
		compatible = "mediatek,mcupm_sram1";
		reg = <0x0 0x10218000 0x0 0x1000>;
	};

	mcupm_sram2@10211000 {
		compatible = "mediatek,mcupm_sram2";
		reg = <0x0 0x10211000 0x0 0x1000>;
	};

	mcupm_sram3@10213000 {
		compatible = "mediatek,mcupm_sram3";
		reg = <0x0 0x10213000 0x0 0x1000>;
	};

	md1_sim1_hot_plug_eint {
		linux,phandle = <0x89>;
		phandle = <0x89>;
	};

	md1_sim2_hot_plug_eint {
		linux,phandle = <0x8a>;
		phandle = <0x8a>;
	};

	md_ccif0@1020a000 {
		compatible = "mediatek,md_ccif0";
		reg = <0x0 0x1020a000 0x0 0x1000>;
	};

	md_ccif1@1020c000 {
		compatible = "mediatek,md_ccif1";
		reg = <0x0 0x1020c000 0x0 0x1000>;
	};

	md_ccif2@1023d000 {
		compatible = "mediatek,md_ccif2";
		reg = <0x0 0x1023d000 0x0 0x1000>;
	};

	md_ccif3@1023f000 {
		compatible = "mediatek,md_ccif3";
		reg = <0x0 0x1023f000 0x0 0x1000>;
	};

	mdcldma@10014000 {
		clock-names = "scp-sys-md1-main", "infra-cldma-bclk", "infra-ccif-ap", "infra-ccif-md", "infra-ccif1-ap", "infra-ccif1-md", "infra-ccif2-ap", "infra-ccif2-md";
		clocks = <0x25 0x0 0x24 0x32 0x24 0x29 0x24 0x2c 0x24 0x23 0x24 0x24 0x24 0x51 0x24 0x52>;
		compatible = "mediatek,mdcldma";
		interrupts = <0x0 0xa5 0x4 0x0 0x94 0x8 0x0 0x95 0x8 0x0 0x105 0x2>;
		linux,phandle = <0x1c>;
		mediatek,cldma_capability = <0x6>;
		mediatek,md_id = <0x0>;
		phandle = <0x1c>;
		reg = <0x0 0x10014000 0x0 0x1000 0x0 0x1021b000 0x0 0x1000 0x0 0x10209000 0x0 0x1000 0x0 0x1020a000 0x0 0x1000>;
	};

	mdcldmain@1021c000 {
		compatible = "mediatek,mdcldmain";
		reg = <0x0 0x1021c000 0x0 0x400>;
	};

	mdcldmain_ao@10015000 {
		compatible = "mediatek,mdcldmain_ao";
		reg = <0x0 0x10015000 0x0 0x400>;
	};

	mdcldmamisc@1021c800 {
		compatible = "mediatek,mdcldmamisc";
		reg = <0x0 0x1021c800 0x0 0x1000>;
	};

	mdcldmamisc_ao@10015800 {
		compatible = "mediatek,mdcldmamisc_ao";
		reg = <0x0 0x10015800 0x0 0x400>;
	};

	mdcldmaout@1021c400 {
		compatible = "mediatek,mdcldmaout";
		reg = <0x0 0x1021c400 0x0 0x400>;
	};

	mdcldmaout_ao@10015400 {
		compatible = "mediatek,mdcldmaout_ao";
		reg = <0x0 0x10015400 0x0 0x400>;
	};

	mdp_ccorr0@14005000 {
		clock-names = "MDP_CCORR";
		clocks = <0x26 0x1>;
		compatible = "mediatek,mdp_ccorr0";
		interrupts = <0x0 0xe2 0x8>;
		linux,phandle = <0x2e>;
		phandle = <0x2e>;
		reg = <0x0 0x14005000 0x0 0x1000>;
	};

	mdp_rdma0@14004000 {
		clock-names = "MDP_RDMA0";
		clocks = <0x26 0x0>;
		compatible = "mediatek,mdp_rdma0";
		interrupts = <0x0 0xd3 0x8>;
		linux,phandle = <0x27>;
		phandle = <0x27>;
		reg = <0x0 0x14004000 0x0 0x1000>;
	};

	mdp_rsz0@14006000 {
		clock-names = "MDP_RSZ0";
		clocks = <0x26 0x2>;
		compatible = "mediatek,mdp_rsz0";
		interrupts = <0x0 0xd4 0x8>;
		linux,phandle = <0x28>;
		phandle = <0x28>;
		reg = <0x0 0x14006000 0x0 0x1000>;
	};

	mdp_rsz1@14007000 {
		clock-names = "MDP_RSZ1";
		clocks = <0x26 0x3>;
		compatible = "mediatek,mdp_rsz1";
		interrupts = <0x0 0xd5 0x8>;
		linux,phandle = <0x29>;
		phandle = <0x29>;
		reg = <0x0 0x14007000 0x0 0x1000>;
	};

	mdp_tdshp0@1400a000 {
		clock-names = "MDP_TDSHP";
		clocks = <0x26 0x4>;
		compatible = "mediatek,mdp_tdshp0";
		linux,phandle = <0x2c>;
		phandle = <0x2c>;
		reg = <0x0 0x1400a000 0x0 0x1000>;
	};

	mdp_wdma0@14008000 {
		clock-names = "MDP_WDMA";
		clocks = <0x26 0x6>;
		compatible = "mediatek,mdp_wdma0";
		interrupts = <0x0 0xd8 0x8>;
		linux,phandle = <0x2a>;
		phandle = <0x2a>;
		reg = <0x0 0x14008000 0x0 0x1000>;
	};

	mdp_wrot0@14009000 {
		clock-names = "MDP_WROT0";
		clocks = <0x26 0x5>;
		compatible = "mediatek,mdp_wrot0";
		interrupts = <0x0 0xd7 0x8>;
		linux,phandle = <0x2b>;
		phandle = <0x2b>;
		reg = <0x0 0x14009000 0x0 0x1000>;
	};

	memory {
		device_type = "memory";
		reg = <0x0 0x40000000 0x0 0x20000000>;
	};

	mfg_cfg@13ffe000 {
		#clock-cells = <0x1>;
		compatible = "mediatek,mfgcfg", "syscon";
		linux,phandle = <0x74>;
		phandle = <0x74>;
		reg = <0x0 0x13ffe000 0x0 0x1000>;
	};

	mfg_doma@13000000 {
		clock-frequency = <0x21f98280>;
		compatible = "mediatek,doma";
		interrupt-names = "RGX";
		interrupts = <0x0 0x103 0x8>;
		reg = <0x0 0x13000000 0x0 0x80000>;
	};

	mipi_rx_ana_csi0a@11c10000 {
		#clock-cells = <0x1>;
		compatible = "mediatek,mipi_rx_ana_csi0a", "syscon";
		linux,phandle = <0x44>;
		phandle = <0x44>;
		reg = <0x0 0x11c10000 0x0 0x1000>;
	};

	mipi_rx_ana_csi0b@11c11000 {
		#clock-cells = <0x1>;
		compatible = "mediatek,mipi_rx_ana_csi0b", "syscon";
		linux,phandle = <0x45>;
		phandle = <0x45>;
		reg = <0x0 0x11c11000 0x0 0x1000>;
	};

	mipi_rx_ana_csi1a@11c12000 {
		#clock-cells = <0x1>;
		compatible = "mediatek,mipi_rx_ana_csi1a", "syscon";
		linux,phandle = <0x46>;
		phandle = <0x46>;
		reg = <0x0 0x11c12000 0x0 0x1000>;
	};

	mipi_rx_ana_csi1b@11c13000 {
		#clock-cells = <0x1>;
		compatible = "mediatek,mipi_rx_ana_csi1b", "syscon";
		linux,phandle = <0x47>;
		phandle = <0x47>;
		reg = <0x0 0x11c13000 0x0 0x1000>;
	};

	mipi_rx_ana_csi2a@11c14000 {
		#clock-cells = <0x1>;
		compatible = "mediatek,mipi_rx_ana_csi2a", "syscon";
		linux,phandle = <0x48>;
		phandle = <0x48>;
		reg = <0x0 0x11c14000 0x0 0x1000>;
	};

	mipi_rx_ana_csi2b@11c15000 {
		#clock-cells = <0x1>;
		compatible = "mediatek,mipi_rx_ana_csi2b", "syscon";
		linux,phandle = <0x49>;
		phandle = <0x49>;
		reg = <0x0 0x11c15000 0x0 0x1000>;
	};

	mipi_tx0@11c80000 {
		compatible = "mediatek,mipi_tx0";
		reg = <0x0 0x11c80000 0x0 0x10000>;
	};

	mmdvfs_pmqos {
		cam_freq = "mm_step0", "mm_step1", "mm_step2";
		clock-names = "mmdvfs_clk_mm_sel_ck", "mmdvfs_clk_mmpll_ck", "mmdvfs_clk_univpll1_d2_ck", "mmdvfs_clk_mmpll_d2_ck";
		clocks = <0x1e 0x4f 0x1e 0x20 0x1e 0x16 0x1e 0x21>;
		compatible = "mediatek,mmdvfs_pmqos";
		disp_freq = "mm_step0", "mm_step1", "mm_step2";
		img_freq = "mm_step0", "mm_step1", "mm_step2";
		mdp_freq = "mm_step0", "mm_step1", "mm_step2";
		mm_step0 = <0x1c9 0x1 0x0 0x1>;
		mm_step1 = <0x138 0x1 0x0 0x2>;
		mm_step2 = <0xe4 0x1 0x0 0x3>;
		vdec_freq = "mm_step0", "mm_step1", "mm_step2";
		venc_freq = "mm_step0", "mm_step1", "mm_step2";
		vopp_steps = <0x0 0x1 0x3>;
	};

	mmsys_config@14000000 {
		#clock-cells = <0x1>;
		clock-names = "CAM_MDP", "IMG_DL_RELAY", "IMG_DL_ASYNC_TOP";
		clocks = <0x26 0x17 0x26 0x1a 0x26 0x1b>;
		compatible = "mediatek,mmsys_config", "syscon";
		interrupts = <0x0 0xe3 0x8>;
		linux,phandle = <0x26>;
		phandle = <0x26>;
		reg = <0x0 0x14000000 0x0 0x1000>;
	};

	mobicore {
		compatible = "trustonic,mobicore";
		interrupts = <0x0 0x10f 0x1>;
	};

	modem_temp_share@10018000 {
		compatible = "mediatek,modem_temp_share";
		reg = <0x0 0x10018000 0x0 0x1000>;
	};

	mrdump_ext_rst {
		compatible = "mediatek, mrdump_ext_rst-eint";
		linux,phandle = <0x55>;
		mode = "IRQ";
		phandle = <0x55>;
		source = "EINT";
		status = "okay";
	};

	msdc0_pad_macro@11cd0000 {
		compatible = "mediatek,msdc0_pad_macro";
		reg = <0x0 0x11cd0000 0x0 0x10000>;
	};

	msdc0_top@11cd0000 {
		compatible = "mediatek,msdc0_top";
		reg = <0x0 0x11cd0000 0x0 0x1000>;
	};

	msdc1_ins@0 {
		compatible = "mediatek,mt6765-sdcard-ins";
		linux,phandle = <0x72>;
		phandle = <0x72>;
	};

	msdc1_pad_macro@11c90000 {
		compatible = "mediatek,msdc1_pad_macro";
		reg = <0x0 0x11c90000 0x0 0x10000>;
	};

	msdc1_top@11c90000 {
		compatible = "mediatek,msdc1_top";
		reg = <0x0 0x11c90000 0x0 0x1000>;
	};

	msdc@11230000 {
		bootable;
		bus-width = <0x8>;
		cap-mmc-highspeed;
		clk_src = [01];
		clock-names = "msdc0-clock", "msdc0-hclock", "msdc0-aes-clock";
		clocks = <0x24 0x4c 0x24 0x1c 0x24 0x44>;
		compatible = "mediatek,msdc";
		host_function = [00];
		index = [00];
		interrupts = <0x0 0x4f 0x8>;
		linux,phandle = <0x6e>;
		max-frequency = <0xbebc200>;
		mmc-ddr-1_8v;
		mmc-hs200-1_8v;
		mmc-hs400-1_8v;
		no-sd;
		no-sdio;
		non-removable;
		phandle = <0x6e>;
		pinctl = <0x32>;
		pinctl_hs200 = <0x34>;
		pinctl_hs400 = <0x33>;
		reg = <0x0 0x11230000 0x0 0x10000>;
		register_setting = <0x35>;
		status = "okay";
		vmmc-supply = <0x36>;
	};

	msdc@11240000 {
		bus-width = <0x4>;
		cap-sd-highspeed;
		cd-gpios = <0x3c 0x1 0x0>;
		cd_level = [01];
		clk_src = [02];
		clock-names = "msdc1-clock", "msdc1-hclock";
		clocks = <0x24 0x4d 0x24 0x1d>;
		compatible = "mediatek,msdc";
		host_function = [01];
		index = [01];
		interrupts = <0x0 0x50 0x8>;
		linux,phandle = <0x6f>;
		max-frequency = <0xbebc200>;
		no-mmc;
		no-sdio;
		phandle = <0x6f>;
		pinctl = <0x37>;
		pinctl_ddr50 = <0x3a>;
		pinctl_sdr104 = <0x38>;
		pinctl_sdr50 = <0x39>;
		reg = <0x0 0x11240000 0x0 0x10000>;
		register_setting = <0x3b>;
		sd-uhs-ddr50;
		sd-uhs-sdr104;
		sd-uhs-sdr12;
		sd-uhs-sdr25;
		sd-uhs-sdr50;
		status = "okay";
		vmmc-supply = <0x3d>;
		vqmmc-supply = <0x3e>;
	};

	msdc@11250000 {
		compatible = "mediatek,msdc2";
		linux,phandle = <0x70>;
		phandle = <0x70>;
		reg = <0x0 0x11250000 0x0 0x10000>;
		status = "disable";
	};

	msdc@11260000 {
		compatible = "mediatek,msdc3";
		linux,phandle = <0x71>;
		phandle = <0x71>;
		reg = <0x0 0x11250000 0x0 0x10000>;
		status = "disable";
	};

	mt6357_gauge {
		alias_name = "mt6357";
		compatible = "mediatek,mt6357_gauge";
		gauge_name = "gauge";
	};

	mt6370_pd_eint {
		linux,phandle = <0x81>;
		phandle = <0x81>;
	};

	mt6370_pmu_dts {
		#interrupt-cells = <0x1>;
		interrupt-controller;
		linux,phandle = <0xa8>;
		mt6370,intr_gpio = <0x3c 0x3 0x0>;
		mt6370,intr_gpio_num = <0x3>;
		phandle = <0xa8>;

		bled {
			compatible = "mediatek,mt6370_pmu_bled";
			interrupt-names = "bled_ocp";
			mt,bl_ocp_level = <0x2>;
			mt,bl_ovp_level = <0x3>;
			mt,bled_flash_ramp = <0x1>;
			mt,bled_name = "mt6370_pmu_bled";
			mt,bled_ramptime = <0x3>;
			mt,chan_en = <0xe>;
			mt,map_linear;
			mt,max_bled_brightness = <0x554>;
			mt,pwm_avg_cycle = <0x0>;
			mt,pwm_deglitch = <0x1>;
			mt,pwm_fsample = <0x2>;
			mt,pwm_hys = <0x1>;
			mt,pwm_hys_en = <0x1>;
			mt,use_pwm;
		};

		charger {
			aicr = <0x7a120>;
			charger_name = "primary_chg";
			compatible = "mediatek,mt6370_pmu_charger";
			cv = <0x432380>;
			dc_wdt = <0x3d0900>;
			enable_te;
			enable_wdt;
			ichg = <0x1e8480>;
			ieoc = <0x30d40>;
			interrupt-names = "chg_mivr", "chg_aiclmeasi", "attachi", "ovpctrl_uvp_d_evt", "chg_wdtmri", "chg_vbusov", "chg_tmri", "chg_treg";
			ircmp_resistor = <0x61a8>;
			ircmp_vclamp = <0x7d00>;
			load_switch_name = "primary_load_switch";
			mivr = <0x432380>;
			safety_timer = <0xc>;
		};

		core {
			compatible = "mediatek,mt6370_pmu_core";
			i2cstmr_rst_tmr = <0x0>;
			int_deg = <0x0>;
			int_wdt = <0x0>;
			interrupt-names = "otp", "vdda_ovp", "vdda_uv";
			mrstb_en;
			mrstb_tmr = <0x3>;
		};

		dsv {
			compatible = "mediatek,mt6370_pmu_dsv";
			db_delay = <0x3>;
			db_ext_en = <0x0>;
			db_freq_pm = <0x0>;
			db_periodic_fix = <0x0>;
			db_periodic_mode = <0x0>;
			db_single_pin = <0x0>;
			db_startup = <0x0>;
			db_vbst = <0x1644>;
			db_vneg_20ms = <0x1>;
			db_vneg_disc = <0x0>;
			db_vneg_slew = <0x1>;
			db_vpos_20ms = <0x1>;
			db_vpos_disc = <0x1>;
			db_vpos_slew = <0x1>;
			interrupt-names = "dsv_vneg_ocp", "dsv_vpos_ocp", "dsv_bst_ocp", "dsv_vneg_scp", "dsv_vpos_scp";

			mt6370_dsvn {
				regulator-max-microvolt = <0x5b8d80>;
				regulator-min-microvolt = <0x3d0900>;
				regulator-name = "dsv_neg";
			};

			mt6370_dsvp {
				regulator-max-microvolt = <0x5b8d80>;
				regulator-min-microvolt = <0x3d0900>;
				regulator-name = "dsv_pos";
			};
		};

		ldo {
			compatible = "mediatek,mt6370_pmu_ldo";
			interrupt-names = "ldo_oc";
			ldo_oms = <0x1>;
			ldo_vrc_lt = <0x1>;

			mt6370_ldo {
				regulator-max-microvolt = <0x3d0900>;
				regulator-min-microvolt = <0x186a00>;
				regulator-name = "irtx_ldo";
			};
		};

		mt6370_pmu_fled1 {
			compatible = "mediatek,mt6370_pmu_fled1";
			fled_enable = <0x1>;
			interrupt-names = "fled_lvf", "fled2_short", "fled1_short";
			strobe_cur = <0x124f80>;
			strobe_timeout = <0x960>;
			torch_cur = <0x493e0>;
		};

		mt6370_pmu_fled2 {
			compatible = "mediatek,mt6370_pmu_fled2";
			fled_enable = <0x1>;
			strobe_cur = <0xf4240>;
			strobe_timeout = <0x4b0>;
			torch_cur = <0x30d40>;
		};

		rgbled {
			compatible = "mediatek,mt6370_pmu_rgbled";
			interrupt-names = "isink4_short", "isink3_short", "isink2_short", "isink1_short", "isink4_open", "isink3_open", "isink2_open", "isink1_open";
			mt,led_default_trigger = "cc_mode", "cc_mode", "cc_mode", "none";
			mt,led_name = "mt6370_pmu_led1", "mt6370_pmu_led2", "mt6370_pmu_led3", "mt6370_pmu_led4";
		};
	};

	mt6370_pmu_eint {
		linux,phandle = <0x80>;
		phandle = <0x80>;
	};

	mt_charger {
		compatible = "mediatek,mt-charger";
		linux,phandle = <0x7c>;
		phandle = <0x7c>;
	};

	mt_pmic_regulator {
		compatible = "mediatek,mt_pmic";

		buck_regulators {
			compatible = "mediatek,mt_pmic_buck_regulators";

			buck_vcore {
				linux,phandle = <0x8d>;
				phandle = <0x8d>;
				regulator-enable-ramp-delay = <0xdc>;
				regulator-max-microvolt = <0x1406f4>;
				regulator-min-microvolt = <0x7ea5e>;
				regulator-name = "vcore";
				regulator-ramp-delay = <0x186a>;
			};

			buck_vmodem {
				linux,phandle = <0x8c>;
				phandle = <0x8c>;
				regulator-enable-ramp-delay = <0xdc>;
				regulator-max-microvolt = <0x123716>;
				regulator-min-microvolt = <0x7a120>;
				regulator-name = "vmodem";
				regulator-ramp-delay = <0x186a>;
			};

			buck_vpa {
				linux,phandle = <0x8f>;
				phandle = <0x8f>;
				regulator-enable-ramp-delay = <0xdc>;
				regulator-max-microvolt = <0x37b1d0>;
				regulator-min-microvolt = <0x7a120>;
				regulator-name = "vpa";
				regulator-ramp-delay = <0xc350>;
			};

			buck_vproc {
				linux,phandle = <0x8e>;
				phandle = <0x8e>;
				regulator-enable-ramp-delay = <0xdc>;
				regulator-max-microvolt = <0x1406f4>;
				regulator-min-microvolt = <0x7ea5e>;
				regulator-name = "vproc";
				regulator-ramp-delay = <0x186a>;
			};

			buck_vs1 {
				linux,phandle = <0x8b>;
				phandle = <0x8b>;
				regulator-enable-ramp-delay = <0xdc>;
				regulator-max-microvolt = <0x2191c0>;
				regulator-min-microvolt = <0x124f80>;
				regulator-name = "vs1";
				regulator-ramp-delay = <0x30d4>;
			};
		};

		ldo_regulators {
			compatible = "mediatek,mt_pmic_ldo_regulators";

			ldo_vaud28 {
				compatible = "regulator-fixed";
				linux,phandle = <0xa0>;
				phandle = <0xa0>;
				regulator-enable-ramp-delay = <0x108>;
				regulator-max-microvolt = <0x2ab980>;
				regulator-min-microvolt = <0x2ab980>;
				regulator-name = "vaud28";
			};

			ldo_vaux18 {
				compatible = "regulator-fixed";
				linux,phandle = <0x9f>;
				phandle = <0x9f>;
				regulator-enable-ramp-delay = <0x108>;
				regulator-max-microvolt = <0x1b7740>;
				regulator-min-microvolt = <0x1b7740>;
				regulator-name = "vaux18";
			};

			ldo_vcama {
				linux,phandle = <0x99>;
				phandle = <0x99>;
				regulator-enable-ramp-delay = <0x108>;
				regulator-max-microvolt = <0x2ab980>;
				regulator-min-microvolt = <0x2625a0>;
				regulator-name = "vcama";
			};

			ldo_vcamd {
				linux,phandle = <0x9a>;
				phandle = <0x9a>;
				regulator-enable-ramp-delay = <0x108>;
				regulator-max-microvolt = <0x1b7740>;
				regulator-min-microvolt = <0xf4240>;
				regulator-name = "vcamd";
			};

			ldo_vcamio {
				compatible = "regulator-fixed";
				linux,phandle = <0x9b>;
				phandle = <0x9b>;
				regulator-enable-ramp-delay = <0x108>;
				regulator-max-microvolt = <0x1b7740>;
				regulator-min-microvolt = <0x1b7740>;
				regulator-name = "vcamio";
			};

			ldo_vcn18 {
				compatible = "regulator-fixed";
				linux,phandle = <0x98>;
				phandle = <0x98>;
				regulator-enable-ramp-delay = <0x108>;
				regulator-max-microvolt = <0x1b7740>;
				regulator-min-microvolt = <0x1b7740>;
				regulator-name = "vcn18";
			};

			ldo_vcn28 {
				compatible = "regulator-fixed";
				linux,phandle = <0x97>;
				phandle = <0x97>;
				regulator-enable-ramp-delay = <0x108>;
				regulator-max-microvolt = <0x2ab980>;
				regulator-min-microvolt = <0x2ab980>;
				regulator-name = "vcn28";
			};

			ldo_vcn33_bt {
				linux,phandle = <0x95>;
				phandle = <0x95>;
				regulator-enable-ramp-delay = <0x108>;
				regulator-max-microvolt = <0x3567e0>;
				regulator-min-microvolt = <0x325aa0>;
				regulator-name = "vcn33_bt";
			};

			ldo_vcn33_wifi {
				linux,phandle = <0x96>;
				phandle = <0x96>;
				regulator-enable-ramp-delay = <0x108>;
				regulator-max-microvolt = <0x3567e0>;
				regulator-min-microvolt = <0x325aa0>;
				regulator-name = "vcn33_wifi";
			};

			ldo_vdram {
				linux,phandle = <0xa3>;
				phandle = <0xa3>;
				regulator-enable-ramp-delay = <0xce4>;
				regulator-max-microvolt = <0x124f80>;
				regulator-min-microvolt = <0x10c8e0>;
				regulator-name = "vdram";
			};

			ldo_vefuse {
				linux,phandle = <0x94>;
				phandle = <0x94>;
				regulator-enable-ramp-delay = <0x108>;
				regulator-max-microvolt = <0x325aa0>;
				regulator-min-microvolt = <0x124f80>;
				regulator-name = "vefuse";
			};

			ldo_vemc {
				linux,phandle = <0x36>;
				phandle = <0x36>;
				regulator-enable-ramp-delay = <0x2c>;
				regulator-max-microvolt = <0x325aa0>;
				regulator-min-microvolt = <0x2c4020>;
				regulator-name = "vemc";
			};

			ldo_vfe28 {
				compatible = "regulator-fixed";
				linux,phandle = <0x90>;
				phandle = <0x90>;
				regulator-enable-ramp-delay = <0x108>;
				regulator-max-microvolt = <0x2ab980>;
				regulator-min-microvolt = <0x2ab980>;
				regulator-name = "vfe28";
			};

			ldo_vibr {
				linux,phandle = <0xa6>;
				phandle = <0xa6>;
				regulator-enable-ramp-delay = <0x2c>;
				regulator-max-microvolt = <0x325aa0>;
				regulator-min-microvolt = <0x124f80>;
				regulator-name = "vibr";
			};

			ldo_vio18 {
				compatible = "regulator-fixed";
				linux,phandle = <0xa2>;
				phandle = <0xa2>;
				regulator-enable-ramp-delay = <0x108>;
				regulator-max-microvolt = <0x1b7740>;
				regulator-min-microvolt = <0x1b7740>;
				regulator-name = "vio18";
			};

			ldo_vio28 {
				compatible = "regulator-fixed";
				linux,phandle = <0xa1>;
				phandle = <0xa1>;
				regulator-enable-ramp-delay = <0x108>;
				regulator-max-microvolt = <0x2ab980>;
				regulator-min-microvolt = <0x2ab980>;
				regulator-name = "vio28";
			};

			ldo_vldo28 {
				linux,phandle = <0x9c>;
				phandle = <0x9c>;
				regulator-enable-ramp-delay = <0x108>;
				regulator-max-microvolt = <0x2dc6c0>;
				regulator-min-microvolt = <0x2ab980>;
				regulator-name = "vldo28";
			};

			ldo_vmc {
				linux,phandle = <0x3e>;
				phandle = <0x3e>;
				regulator-enable-ramp-delay = <0x2c>;
				regulator-max-microvolt = <0x325aa0>;
				regulator-min-microvolt = <0x1b7740>;
				regulator-name = "vmc";
			};

			ldo_vmch {
				linux,phandle = <0x3d>;
				phandle = <0x3d>;
				regulator-enable-ramp-delay = <0x2c>;
				regulator-max-microvolt = <0x325aa0>;
				regulator-min-microvolt = <0x2c4020>;
				regulator-name = "vmch";
			};

			ldo_vrf12 {
				compatible = "regulator-fixed";
				linux,phandle = <0x93>;
				phandle = <0x93>;
				regulator-enable-ramp-delay = <0x6e>;
				regulator-max-microvolt = <0x124f80>;
				regulator-min-microvolt = <0x124f80>;
				regulator-name = "vrf12";
			};

			ldo_vrf18 {
				compatible = "regulator-fixed";
				linux,phandle = <0x92>;
				phandle = <0x92>;
				regulator-enable-ramp-delay = <0x6e>;
				regulator-max-microvolt = <0x1b7740>;
				regulator-min-microvolt = <0x1b7740>;
				regulator-name = "vrf18";
			};

			ldo_vsim1 {
				linux,phandle = <0xa4>;
				phandle = <0xa4>;
				regulator-enable-ramp-delay = <0x108>;
				regulator-max-microvolt = <0x2f4d60>;
				regulator-min-microvolt = <0x19f0a0>;
				regulator-name = "vsim1";
			};

			ldo_vsim2 {
				linux,phandle = <0xa5>;
				phandle = <0xa5>;
				regulator-enable-ramp-delay = <0x108>;
				regulator-max-microvolt = <0x2f4d60>;
				regulator-min-microvolt = <0x19f0a0>;
				regulator-name = "vsim2";
			};

			ldo_vsram_others {
				linux,phandle = <0x9d>;
				phandle = <0x9d>;
				regulator-enable-ramp-delay = <0x6e>;
				regulator-max-microvolt = <0x1406f4>;
				regulator-min-microvolt = <0x7ea5e>;
				regulator-name = "vsram_others";
				regulator-ramp-delay = <0x186a>;
			};

			ldo_vsram_proc {
				linux,phandle = <0x9e>;
				phandle = <0x9e>;
				regulator-enable-ramp-delay = <0x6e>;
				regulator-max-microvolt = <0x1406f4>;
				regulator-min-microvolt = <0x7ea5e>;
				regulator-name = "vsram_proc";
				regulator-ramp-delay = <0x186a>;
			};

			ldo_vusb33 {
				linux,phandle = <0xa7>;
				phandle = <0xa7>;
				regulator-enable-ramp-delay = <0x108>;
				regulator-max-microvolt = <0x2f4d60>;
				regulator-min-microvolt = <0x2dc6c0>;
				regulator-name = "vusb33";
			};

			ldo_vxo22 {
				linux,phandle = <0x91>;
				phandle = <0x91>;
				regulator-enable-ramp-delay = <0x6e>;
				regulator-max-microvolt = <0x249f00>;
				regulator-min-microvolt = <0x2191c0>;
				regulator-name = "vxo22";
			};
		};
	};

	mt_soc_anc_pcm {
		compatible = "mediatek,mt_soc_pcm_anc";
	};

	mt_soc_btcvsd_rx_pcm {
		compatible = "mediatek,mt_soc_btcvsd_rx_pcm";
	};

	mt_soc_btcvsd_tx_pcm {
		compatible = "mediatek,mt_soc_btcvsd_tx_pcm";
	};

	mt_soc_codec_dummy_name {
		compatible = "mediatek,mt_soc_codec_dummy";
	};

	mt_soc_codec_name {
		compatible = "mediatek,mt_soc_codec_63xx";
		use_hp_depop_flow = <0x0>;
		use_ul_260k = <0x0>;
	};

	mt_soc_dai_name {
		compatible = "mediatek,mt_soc_dai_stub";
	};

	mt_soc_deep_buffer_dl_pcm {
		compatible = "mediatek,mt_soc_pcm_deep_buffer_dl";
	};

	mt_soc_dl1_awb_pcm {
		compatible = "mediatek,mt_soc_pcm_dl1_awb";
	};

	mt_soc_dl1_pcm@11220000 {
		clock-names = "aud_afe_clk", "aud_dac_clk", "aud_dac_predis_clk", "aud_adc_clk", "aud_apll22m_clk", "aud_apll1_tuner_clk", "aud_tml_clk", "aud_infra_clk", "mtkaif_26m_clk", "top_mux_audio", "top_mux_audio_int", "top_sys_pll1_d4", "top_mux_aud_1", "top_apll1_ck", "top_mux_aud_eng1", "top_apll1_d8", "apmixed_apll1", "top_clk26m_clk";
		clocks = <0x3f 0x0 0x3f 0x4 0x3f 0x5 0x3f 0x3 0x3f 0x1 0x3f 0x2 0x3f 0x6 0x24 0x2b 0x24 0x33 0x1e 0x5c 0x1e 0x5d 0x1e 0x3 0x1e 0x5e 0x1e 0x28 0x1e 0x5f 0x1e 0x2b 0x40 0x8 0x1f>;
		compatible = "mediatek,mt_soc_pcm_dl1";
		interrupts = <0x0 0x99 0x8>;
		linux,phandle = <0x73>;
		phandle = <0x73>;
		reg = <0x0 0x11220000 0x0 0x1000>;
	};

	mt_soc_dl2_pcm {
		compatible = "mediatek,mt_soc_pcm_dl2";
	};

	mt_soc_dummy_pcm {
		compatible = "mediatek,mt_soc_pcm_dummy";
	};

	mt_soc_fm_i2s_awb_pcm {
		compatible = "mediatek,mt_soc_pcm_fm_i2s_awb";
	};

	mt_soc_fm_i2s_pcm {
		compatible = "mediatek,mt_soc_pcm_fm_i2s";
	};

	mt_soc_fm_mrgtx_pcm {
		compatible = "mediatek,mt_soc_pcm_fmtx";
	};

	mt_soc_hp_impedance_pcm {
		compatible = "mediatek,mt_soc_pcm_hp_impedance";
	};

	mt_soc_i2s0_awb_pcm {
		compatible = "mediatek,mt_soc_pcm_i2s0_awb";
	};

	mt_soc_i2s0_pcm {
		compatible = "mediatek,mt_soc_pcm_dl1_i2s0";
	};

	mt_soc_i2s0dl1_pcm {
		compatible = "mediatek,mt_soc_pcm_dl1_i2s0dl1";
	};

	mt_soc_mrgrx_awb_pcm {
		compatible = "mediatek,mt_soc_pcm_mrgrx_awb";
	};

	mt_soc_mrgrx_pcm {
		compatible = "mediatek,mt_soc_pcm_mrgrx";
	};

	mt_soc_pcm_dl1_scp_spk {
		compatible = "mediatek,mt_soc_pcm_dl1_scp_spk";
	};

	mt_soc_pcm_voice_scp {
		compatible = "mediatek,mt_soc_pcm_voice_scp";
	};

	mt_soc_pcm_voice_ultra {
		compatible = "mediatek,mt_soc_pcm_voice_ultra";
	};

	mt_soc_pcm_voice_usb {
		compatible = "mediatek,mt_soc_pcm_voice_usb";
	};

	mt_soc_pcm_voice_usb_echoref {
		compatible = "mediatek,mt_soc_pcm_voice_usb_echoref";
	};

	mt_soc_routing_dai_name {
		compatible = "mediatek,mt_soc_dai_routing";
	};

	mt_soc_routing_pcm {
		compatible = "mediatek,mt_soc_pcm_routing";
	};

	mt_soc_tdmrx_pcm {
		compatible = "mediatek,mt_soc_tdm_capture";
	};

	mt_soc_ul1_pcm {
		compatible = "mediatek,mt_soc_pcm_capture";
	};

	mt_soc_ul2_pcm {
		compatible = "mediatek,mt_soc_pcm_capture2";
	};

	mt_soc_uldlloopback_pcm {
		compatible = "mediatek,mt_soc_pcm_uldlloopback";
	};

	mt_soc_voice_md1 {
		compatible = "mediatek,mt_soc_pcm_voice_md1";
	};

	mt_soc_voice_md1_bt {
		compatible = "mediatek,mt_soc_pcm_voice_md1_bt";
	};

	mt_soc_voice_md2 {
		compatible = "mediatek,mt_soc_pcm_voice_md2";
	};

	mt_soc_voice_md2_bt {
		compatible = "mediatek,mt_soc_pcm_voice_md2_bt";
	};

	mt_soc_voip_bt_in {
		compatible = "mediatek,mt_soc_pcm_bt_dai";
	};

	mt_soc_voip_bt_out {
		compatible = "mediatek,mt_soc_pcm_dl1_bt";
	};

	mtkfb@0 {
		compatible = "mediatek,mtkfb";
		linux,phandle = <0x77>;
		phandle = <0x77>;
	};

	nfc {
		compatible = "mediatek,nfc-gpio-v2";
		gpio-irq = <0xa>;
		gpio-irq-std = <0x3c 0xa 0x0>;
		gpio-rst = <0xac>;
		gpio-rst-std = <0x3c 0xac 0x0>;
		linux,phandle = <0x75>;
		phandle = <0x75>;
	};

	nfi@11018000 {
		compatible = "mediatek,nfi";
		reg = <0x0 0x11018000 0x0 0x1000>;
	};

	nfiecc@11019000 {
		compatible = "mediatek,nfiecc";
		reg = <0x0 0x11019000 0x0 0x1000>;
	};

	odm {
		compatible = "simple-bus";
		linux,phandle = <0x83>;
		phandle = <0x83>;
	};

	otg_iddig {
		compatible = "mediatek,usb_iddig_bi_eint";
		linux,phandle = <0x54>;
		phandle = <0x54>;
	};

	pericfg@10003000 {
		#clock-cells = <0x1>;
		compatible = "mediatek,pericfg", "syscon";
		linux,phandle = <0x4e>;
		phandle = <0x4e>;
		reg = <0x0 0x10003000 0x0 0x1000>;
	};

	pinctrl@1000b000 {
		#gpio-cells = <0x2>;
		#interrupt-cells = <0x4>;
		compatible = "mediatek,mt6765-pinctrl";
		gpio-controller;
		interrupt-controller;
		interrupts = <0x0 0xab 0x4>;
		linux,phandle = <0x3c>;
		mediatek,pctl-regmap = <0x12 0x13 0x14 0x15 0x16 0x17 0x18 0x19>;
		phandle = <0x3c>;
		pins-are-numbered;
		reg = <0x0 0x1000b000 0x0 0x1000>;

		msdc0@default {
			linux,phandle = <0x32>;
			phandle = <0x32>;

			pins_clk {
				drive-strength = [03];
			};

			pins_cmd {
				drive-strength = [03];
			};

			pins_dat {
				drive-strength = [03];
			};

			pins_ds {
				drive-strength = [03];
			};

			pins_rst {
				drive-strength = [03];
			};
		};

		msdc0@hs200 {
			linux,phandle = <0x34>;
			phandle = <0x34>;

			pins_clk {
				drive-strength = [04];
			};

			pins_cmd {
				drive-strength = [03];
			};

			pins_dat {
				drive-strength = [04];
			};

			pins_ds {
				drive-strength = [04];
			};

			pins_rst {
				drive-strength = [03];
			};
		};

		msdc0@hs400 {
			linux,phandle = <0x33>;
			phandle = <0x33>;

			pins_clk {
				drive-strength = [04];
			};

			pins_cmd {
				drive-strength = [03];
			};

			pins_dat {
				drive-strength = [04];
			};

			pins_ds {
				drive-strength = [04];
			};

			pins_rst {
				drive-strength = [03];
			};
		};

		msdc0@register_default {
			cmd_edge = [00];
			linux,phandle = <0x35>;
			phandle = <0x35>;
			rdata_edge = [00];
			wdata_edge = [00];
		};

		msdc1@ddr50 {
			linux,phandle = <0x3a>;
			phandle = <0x3a>;

			pins_clk {
				drive-strength = [03];
			};

			pins_cmd {
				drive-strength = [03];
			};

			pins_dat {
				drive-strength = [03];
			};
		};

		msdc1@default {
			linux,phandle = <0x37>;
			phandle = <0x37>;

			pins_clk {
				drive-strength = [03];
			};

			pins_cmd {
				drive-strength = [03];
			};

			pins_dat {
				drive-strength = [03];
			};
		};

		msdc1@register_default {
			cmd_edge = [00];
			linux,phandle = <0x3b>;
			phandle = <0x3b>;
			rdata_edge = [00];
			wdata_edge = [00];
		};

		msdc1@sdr104 {
			linux,phandle = <0x38>;
			phandle = <0x38>;

			pins_clk {
				drive-strength = [03];
			};

			pins_cmd {
				drive-strength = [03];
			};

			pins_dat {
				drive-strength = [03];
			};
		};

		msdc1@sdr50 {
			linux,phandle = <0x39>;
			phandle = <0x39>;

			pins_clk {
				drive-strength = [03];
			};

			pins_cmd {
				drive-strength = [03];
			};

			pins_dat {
				drive-strength = [03];
			};
		};

		msdc3@default {
			linux,phandle = <0x51>;
			phandle = <0x51>;

			pins_clk {
				drive-strength = [04];
			};

			pins_cmd {
				drive-strength = [04];
			};

			pins_dat {
				drive-strength = [04];
			};
		};

		msdc3@register_default {
			cmd_edge = [01];
			linux,phandle = <0x52>;
			phandle = <0x52>;
			rdata_edge = [01];
			wdata_edge = [01];
		};
	};

	plat_sram_flag@0011db00 {
		compatible = "mediatek,plat_sram_flag";
		reg = <0x0 0x10e5f0 0x0 0x10>;
	};

	pmic_clock_buffer_ctrl {
		compatible = "mediatek,pmic_clock_buffer";
		linux,phandle = <0x84>;
		mediatek,clkbuf-config = <0x2 0x1 0x1 0x2 0x0 0x0 0x0>;
		mediatek,clkbuf-driving-current = <0x1 0x1 0x1 0x1 0x1 0x1 0x1>;
		mediatek,clkbuf-quantity = <0x7>;
		phandle = <0x84>;
	};

	pmu {
		compatible = "arm,armv8-pmuv3";
		interrupt-parent = <0x11>;
		interrupts = <0x1 0x7 0x8>;
	};

	psci {
		compatible = "arm,psci-1.0";
		method = "smc";
	};

	pseudo_m4u {
		compatible = "mediatek,mt-pseudo_m4u";
		iommus = <0x4a 0x2>;
	};

	pseudo_m4u-larb0 {
		compatible = "mediatek,mt-pseudo_m4u-port";
		iommus = <0x4a 0x0 0x4a 0x1 0x4a 0x2 0x4a 0x3 0x4a 0x4 0x4a 0x5 0x4a 0x6 0x4a 0x7>;
		mediatek,larbid = <0x0>;
	};

	pseudo_m4u-larb1 {
		compatible = "mediatek,mt-pseudo_m4u-port";
		iommus = <0x4a 0x20 0x4a 0x21>;
		mediatek,larbid = <0x1>;
	};

	pseudo_m4u-larb2 {
		compatible = "mediatek,mt-pseudo_m4u-port";
		iommus = <0x4a 0x40 0x4a 0x41>;
		mediatek,larbid = <0x2>;
	};

	pseudo_m4u-larb3 {
		compatible = "mediatek,mt-pseudo_m4u-port";
		iommus = <0x4a 0x60 0x4a 0x61>;
		mediatek,larbid = <0x3>;
	};

	pwm@11006000 {
		clock-names = "PWM1-main", "PWM2-main", "PWM3-main", "PWM4-main", "PWM5-main", "PWM6-main", "PWM-HCLK-main", "PWM-main";
		clocks = <0x24 0x10 0x24 0x11 0x24 0x12 0x24 0x13 0x24 0x14 0x24 0x30 0x24 0xf 0x24 0x15>;
		compatible = "mediatek,pwm";
		interrupts = <0x0 0x4d 0x8>;
		linux,phandle = <0x67>;
		phandle = <0x67>;
		reg = <0x0 0x11006000 0x0 0x10000>;
	};

	pwrap@1000d000 {
		compatible = "mediatek,pwrap";
		interrupts = <0x0 0xb3 0x4>;
		reg = <0x0 0x1000d000 0x0 0x1000>;

		pmic_irq {
			compatible = "mediatek,pmic-eint";
			interrupt-controller;
			linux,phandle = <0x53>;
			phandle = <0x53>;
		};
	};

	reserved-memory {
		#address-cells = <0x2>;
		#size-cells = <0x2>;
		linux,phandle = <0x4c>;
		phandle = <0x4c>;
		ranges;

		consys-reserve-memory {
			alignment = <0x0 0x1000000>;
			alloc-ranges = <0x0 0x40000000 0x0 0x80000000>;
			compatible = "mediatek,consys-reserve-memory";
			no-map;
			size = <0x0 0x400000>;
		};

		minirdump-reserved-memory@544f0000 {
			compatible = "mediatek,minirdump";
			reg = <0x0 0x544f0000 0x0 0x10000>;
		};

		pstore-reserved-memory@54410000 {
			compatible = "mediatek,pstore";
			reg = <0x0 0x54410000 0x0 0xe0000>;
		};

		ram_console-reserved-memory@54400000 {
			compatible = "mediatek,ram_console";
			reg = <0x0 0x54400000 0x0 0x10000>;
		};

		reserve-memory-scp_share {
			alignment = <0x0 0x1000000>;
			alloc-ranges = <0x0 0x40000000 0x0 0x50000000>;
			compatible = "mediatek,reserve-memory-scp_share";
			no-map;
			size = <0x0 0xd00000>;
		};

		reserve-memory-sspm_share {
			alignment = <0x0 0x10000>;
			alloc-ranges = <0x0 0x40000000 0x0 0x60000000>;
			compatible = "mediatek,reserve-memory-sspm_share";
			no-map;
			size = <0x0 0x110000>;
			status = "okay";
		};

		soter-shared-mem {
			alloc-ranges = <0x0 0x40000000 0x0 0x50000000>;
			compatible = "microtrust,shared_mem";
			no-map;
			size = <0x0 0x500000>;
		};

		wifi-reserve-memory {
			alignment = <0x0 0x1000000>;
			alloc-ranges = <0x0 0x40000000 0x0 0x80000000>;
			compatible = "mediatek,wifi-reserve-memory";
			no-map;
			size = <0x0 0x300000>;
		};
	};

	rt-pd-manager {
		compatible = "mediatek,rt-pd-manager";
	};

	rt9465_slave_chr {
		compatible = "richtek,rt9465";
		linux,phandle = <0x7f>;
		phandle = <0x7f>;
		status = "disabled";
	};

	scp@10500000 {
		compatible = "mediatek,scp";
		core_1 = "enable";
		interrupts = <0x0 0xc0 0x4>;
		reg = <0x0 0x10500000 0x0 0x40000 0x0 0x105c0000 0x0 0x3000 0x0 0x105c4000 0x0 0x1000>;
		scp_sramSize = <0x40000>;
		status = "okay";
	};

	scp_dvfs {
		clock-names = "clk_mux", "clk_pll_0", "clk_pll_1", "clk_pll_2", "clk_pll_3", "clk_pll_4", "clk_pll_5", "clk_pll_6";
		clocks = <0x1e 0x50 0x1f 0x1e 0xe 0x1e 0x19 0x1e 0x2 0x1e 0x16 0x1e 0x6 0x1e 0x18>;
		compatible = "mediatek,scp_dvfs";
	};

	scpsys@10001000 {
		#clock-cells = <0x1>;
		compatible = "mediatek,scpsys", "syscon";
		linux,phandle = <0x25>;
		phandle = <0x25>;
		reg = <0x0 0x10001000 0x0 0x1000 0x0 0x10006000 0x0 0x1000 0x0 0x14002000 0x0 0x1000 0x0 0x1020e000 0x0 0x1000 0x0 0x18004000 0x0 0x1000 0x0 0x18002000 0x0 0x1000>;
	};

	security_ao@1001a000 {
		compatible = "mediatek,security_ao";
		reg = <0x0 0x1001a000 0x0 0x1000>;
	};

	seninf1@1a040000 {
		compatible = "mediatek,seninf1";
		reg = <0x0 0x1a040000 0x0 0x1000>;
	};

	seninf2@1a041000 {
		compatible = "mediatek,seninf2";
		reg = <0x0 0x1a041000 0x0 0x1000>;
	};

	seninf3@1a042000 {
		compatible = "mediatek,seninf3";
		reg = <0x0 0x1a042000 0x0 0x1000>;
	};

	seninf4@1a043000 {
		compatible = "mediatek,seninf4";
		reg = <0x0 0x1a043000 0x0 0x1000>;
	};

	serial@11020000 {
		clock-names = "baud", "bus";
		clocks = <0x1f 0x24 0x16>;
		compatible = "mediatek,mt6758-uart", "mediatek,mt6577-uart";
		dma-names = "tx", "rx";
		dmas = <0x31 0x0 0x31 0x1>;
		interrupts = <0x0 0x5b 0x8>;
		linux,phandle = <0x5d>;
		phandle = <0x5d>;
		reg = <0x0 0x11002000 0x0 0x1000>;
	};

	serial@11030000 {
		clock-names = "baud", "bus";
		clocks = <0x1f 0x24 0x17>;
		compatible = "mediatek,mt6758-uart", "mediatek,mt6577-uart";
		interrupts = <0x0 0x5c 0x8>;
		linux,phandle = <0x5e>;
		phandle = <0x5e>;
		reg = <0x0 0x11003000 0x0 0x1000>;
	};

	sleep@10006000 {
		compatible = "mediatek,sleep";
		interrupts = <0x0 0xb5 0x8>;
		reg = <0x0 0x10006000 0x0 0x1000>;
		wakeup-source = <0x1a 0x0 0x4 0x1b 0x1 0x20 0x1c 0x3 0x2000000>;
	};

	sleep_reg_md@1000f000 {
		compatible = "mediatek,sleep_reg_md";
		reg = <0x0 0x1000f000 0x0 0x1000>;
	};

	smart_pa {
		linux,phandle = <0x88>;
		phandle = <0x88>;
	};

	smi_common@14002000 {
		clock-names = "mtcmos-mm", "smi-common-gals-comm0", "smi-common-gals-comm1", "smi-common", "mmdvfs_clk_mm_sel_ck", "mmdvfs_clk_mmpll_ck", "mmdvfs_clk_univpll1_d2_ck", "mmdvfs_clk_mmpll_d2_ck";
		clocks = <0x25 0x3 0x26 0x15 0x26 0x16 0x26 0x13 0x1e 0x4f 0x1e 0x20 0x1e 0x16 0x1e 0x21>;
		compatible = "mediatek,smi_common";
		larbs = <0x20 0x21 0x22 0x23>;
		mmsys_config = <0x26>;
		nr_larbs = <0x4>;
		reg = <0x0 0x14002000 0x0 0x1000>;
	};

	smi_larb0@14003000 {
		cell-index = <0x0>;
		clock-names = "mtcmos-mm", "mm-larb0";
		clocks = <0x25 0x3 0x26 0x14>;
		compatible = "mediatek,smi_larb0", "mediatek,smi_larb";
		linux,phandle = <0x20>;
		phandle = <0x20>;
		reg = <0x0 0x14003000 0x0 0x1000>;
	};

	smi_larb1@17010000 {
		cell-index = <0x1>;
		clock-names = "mtcmos-vcodec", "venc-larb1";
		clocks = <0x25 0xa 0x43 0x1>;
		compatible = "mediatek,smi_larb1", "mediatek,smi_larb";
		linux,phandle = <0x21>;
		phandle = <0x21>;
		reg = <0x0 0x17010000 0x0 0x1000>;
	};

	smi_larb2@15021000 {
		cell-index = <0x2>;
		clock-names = "mtcmos-isp", "gals-img2mm", "img-larb2";
		clocks = <0x25 0x5 0x26 0x18 0x41 0x0>;
		compatible = "mediatek,smi_larb2", "mediatek,smi_larb";
		linux,phandle = <0x22>;
		phandle = <0x22>;
		reg = <0x0 0x15021000 0x0 0x1000>;
	};

	smi_larb3@1a002000 {
		cell-index = <0x3>;
		clock-names = "mtcmos-cam", "gals-cam2mm", "cam-larb3";
		clocks = <0x25 0x9 0x26 0x19 0x42 0x0>;
		compatible = "mediatek,smi_larb3", "mediatek,smi_larb";
		linux,phandle = <0x23>;
		phandle = <0x23>;
		reg = <0x0 0x1a002000 0x0 0x1000>;
	};

	spi@1100a000 {
		clock-names = "parent-clk", "sel-clk", "spi-clk";
		clocks = <0x1e 0xb 0x1e 0x58 0x24 0x1b>;
		compatible = "mediatek,mt6765-spi";
		interrupts = <0x0 0x76 0x8>;
		linux,phandle = <0x68>;
		mediatek,pad-select = <0x0>;
		phandle = <0x68>;
		reg = <0x0 0x1100a000 0x0 0x1000>;
	};

	spi@11010000 {
		clock-names = "parent-clk", "sel-clk", "spi-clk";
		clocks = <0x1e 0xb 0x1e 0x58 0x24 0x34>;
		compatible = "mediatek,mt6765-spi";
		interrupts = <0x0 0x7a 0x8>;
		linux,phandle = <0x69>;
		mediatek,pad-select = <0x0>;
		phandle = <0x69>;
		reg = <0x0 0x11010000 0x0 0x1000>;
	};

	spi@11012000 {
		clock-names = "parent-clk", "sel-clk", "spi-clk";
		clocks = <0x1e 0xb 0x1e 0x58 0x24 0x37>;
		compatible = "mediatek,mt6765-spi";
		interrupts = <0x0 0x80 0x8>;
		linux,phandle = <0x6a>;
		mediatek,pad-select = <0x0>;
		phandle = <0x6a>;
		reg = <0x0 0x11012000 0x0 0x1000>;
	};

	spi@11013000 {
		clock-names = "parent-clk", "sel-clk", "spi-clk";
		clocks = <0x1e 0xb 0x1e 0x58 0x24 0x38>;
		compatible = "mediatek,mt6765-spi";
		interrupts = <0x0 0x81 0x8>;
		linux,phandle = <0x6b>;
		mediatek,pad-select = <0x0>;
		phandle = <0x6b>;
		reg = <0x0 0x11013000 0x0 0x1000>;
	};

	spi@11014000 {
		clock-names = "parent-clk", "sel-clk", "spi-clk";
		clocks = <0x1e 0xb 0x1e 0x58 0x24 0x41>;
		compatible = "mediatek,mt6765-spi";
		interrupts = <0x0 0x5f 0x8>;
		linux,phandle = <0x6c>;
		mediatek,pad-select = <0x0>;
		phandle = <0x6c>;
		reg = <0x0 0x11014000 0x0 0x1000>;
	};

	spi@11015000 {
		clock-names = "parent-clk", "sel-clk", "spi-clk";
		clocks = <0x1e 0xb 0x1e 0x58 0x24 0x42>;
		compatible = "mediatek,mt6765-spi";
		interrupts = <0x0 0x60 0x8>;
		linux,phandle = <0x6d>;
		mediatek,pad-select = <0x0>;
		phandle = <0x6d>;
		reg = <0x0 0x11015000 0x0 0x1000>;
	};

	sramrom@10214000 {
		compatible = "mediatek,sramrom";
		reg = <0x0 0x10214000 0x0 0x1000>;
	};

	sspm@10440000 {
		compatible = "mediatek,sspm";
		interrupt-names = "ipc", "mbox0", "mbox1", "mbox2", "mbox3", "mbox4";
		interrupts = <0x0 0xca 0x4 0x0 0xcd 0x4 0x0 0xce 0x4 0x0 0xcf 0x4 0x0 0xd0 0x4 0x0 0xd1 0x4>;
		reg = <0x0 0x10440000 0x0 0x10000 0x0 0x10450000 0x0 0x100 0x0 0x10451000 0x0 0x8 0x0 0x10460000 0x0 0x100 0x0 0x10461000 0x0 0x8 0x0 0x10470000 0x0 0x100 0x0 0x10471000 0x0 0x8 0x0 0x10480000 0x0 0x100 0x0 0x10481000 0x0 0x8 0x0 0x10490000 0x0 0x100 0x0 0x10491000 0x0 0x8>;
		reg-names = "cfgreg", "mbox0_base", "mbox0_ctrl", "mbox1_base", "mbox1_ctrl", "mbox2_base", "mbox2_ctrl", "mbox3_base", "mbox3_ctrl", "mbox4_base", "mbox4_ctrl";
	};

	swtp {
		compatible = "mediatek, swtp-eint";
		linux,phandle = <0x56>;
		phandle = <0x56>;
	};

	sys_cirq@10204000 {
		compatible = "mediatek,sys_cirq";
		interrupts = <0x0 0x118 0x8>;
		mediatek,cirq_num = <0xd1>;
		mediatek,spi_start_offset = <0x48>;
		reg = <0x0 0x10204000 0x0 0x1000>;
	};

	sys_timer@10017000 {
		compatible = "mediatek,sys_timer";
		interrupts = <0x0 0xc2 0x4>;
		reg = <0x0 0x10017000 0x0 0x1000>;
		reg-names = "sys_timer_base";
	};

	syscfg_pctl_0@10005000 {
		compatible = "mediatek,mt6765-pctl-0-syscfg", "syscon";
		linux,phandle = <0x12>;
		phandle = <0x12>;
		reg = <0x0 0x10005000 0x0 0x1000>;
	};

	syscfg_pctl_1@0x10002000 {
		compatible = "mediatek,mt6765-pctl-1-syscfg", "syscon";
		linux,phandle = <0x13>;
		phandle = <0x13>;
		reg = <0x0 0x10002000 0x0 0x1000>;
	};

	syscfg_pctl_2@0x10002200 {
		compatible = "mediatek,mt6765-pctl-2-syscfg", "syscon";
		linux,phandle = <0x14>;
		phandle = <0x14>;
		reg = <0x0 0x10002200 0x0 0x1000>;
	};

	syscfg_pctl_3@0x10002400 {
		compatible = "mediatek,mt6765-pctl-3-syscfg", "syscon";
		linux,phandle = <0x15>;
		phandle = <0x15>;
		reg = <0x0 0x10002400 0x0 0x1000>;
	};

	syscfg_pctl_4@0x10002600 {
		compatible = "mediatek,mt6765-pctl-4-syscfg", "syscon";
		linux,phandle = <0x16>;
		phandle = <0x16>;
		reg = <0x0 0x10002600 0x0 0x1000>;
	};

	syscfg_pctl_5@0x10002800 {
		compatible = "mediatek,mt6765-pctl-5-syscfg", "syscon";
		linux,phandle = <0x17>;
		phandle = <0x17>;
		reg = <0x0 0x10002800 0x0 0x1000>;
	};

	syscfg_pctl_6@0x10002a00 {
		compatible = "mediatek,mt6765-pctl-6-syscfg", "syscon";
		linux,phandle = <0x18>;
		phandle = <0x18>;
		reg = <0x0 0x10002a00 0x0 0x1000>;
	};

	syscfg_pctl_7@0x10002c00 {
		compatible = "mediatek,mt6765-pctl-7-syscfg", "syscon";
		linux,phandle = <0x19>;
		phandle = <0x19>;
		reg = <0x0 0x10002c00 0x0 0x1000>;
	};

	therm_ctrl@1100b000 {
		clock-names = "therm-main";
		clocks = <0x24 0xa>;
		compatible = "mediatek,therm_ctrl";
		interrupts = <0x0 0x4e 0x8>;
		reg = <0x0 0x1100b000 0x0 0x1000>;
	};

	timer {
		clock-frequency = <0xc65d40>;
		compatible = "arm,armv8-timer";
		interrupt-parent = <0x11>;
		interrupts = <0x1 0xd 0x8 0x1 0xe 0x8 0x1 0xb 0x8 0x1 0xa 0x8>;
	};

	topckgen@10000000 {
		#clock-cells = <0x1>;
		compatible = "mediatek,topckgen", "syscon";
		linux,phandle = <0x1e>;
		phandle = <0x1e>;
		reg = <0x0 0x10000000 0x0 0x1000>;
	};

	topckgen_ao@1001b000 {
		compatible = "mediatek,topckgen_ao";
		reg = <0x0 0x1001b000 0x0 0x1000>;
	};

	topmisc@10011000 {
		compatible = "mediatek,topmisc";
		reg = <0x0 0x10011000 0x0 0x1000>;
	};

	toprgu@10007000 {
		compatible = "mediatek,mt6765-toprgu";
		interrupts = <0x0 0x8b 0x0>;
		reg = <0x0 0x10007000 0x0 0x1000>;
	};

	touch {
		compatible = "mediatek,touch";
		linux,phandle = <0x57>;
		phandle = <0x57>;
	};

	trng@1020f000 {
		compatible = "mediatek,trng";
		interrupts = <0x0 0xa1 0x8>;
		reg = <0x0 0x1020f000 0x0 0x1000>;
	};

	type_c_port0 {
		linux,phandle = <0xa9>;
		mt-tcpc,name = "type_c_port0";
		mt-tcpc,role_def = <0x4>;
		mt-tcpc,rp_level = <0x0>;
		mt-tcpc,vconn_supply = <0x1>;
		mt6370pd,intr_gpio = <0x3c 0x18 0x0>;
		mt6370pd,intr_gpio_num = <0x18>;
		phandle = <0xa9>;
		tcpc-dual,supported_modes = <0x0>;

		dpm_caps {
			attemp_discover_cable;
			attemp_discover_id;
			attemp_enter_dp_mode;
			dr_check = <0x0>;
			local_dr_data;
			local_dr_power;
			local_no_suspend;
			local_usb_comm;
			local_vconn_supply;
			pr_check = <0x0>;
			pr_check_gp_source;
		};

		pd-data {
			bat,nr = <0x1>;
			pd,charging_policy = <0x21>;
			pd,country_nr = <0x0>;
			pd,id-vdo-data = <0xd10029cf 0x0 0x10000>;
			pd,id-vdo-size = <0x3>;
			pd,mfrs = "RichtekTCPC";
			pd,pid = <0x5081>;
			pd,sink-pdo-data = <0x190c8 0xc0761e3c>;
			pd,sink-pdo-size = <0x2>;
			pd,source-cap-ext = <0x171129cf 0x0 0x102 0x0 0x0 0x2000000>;
			pd,source-pdo-data = <0x19032>;
			pd,source-pdo-size = <0x1>;
			pd,vid = <0x29cf>;

			bat-info0 {
				bat,design_cap = <0xbb8>;
				bat,mfrs = "bat1";
				bat,pid = <0x1711>;
				bat,vid = <0x29cf>;
			};
		};
	};

	usb0@11200000 {
		clock-names = "usb0", "usb0_clk_top_sel", "usb0_clk_univpll3_d4";
		clocks = <0x24 0x8 0x1e 0x63 0x1e 0x1f>;
		compatible = "mediatek,mt6765-usb20";
		interrupts = <0x0 0x49 0x8>;
		mode = <0x2>;
		multipoint = <0x1>;
		num_eps = <0x10>;
		reg = <0x0 0x11200000 0x0 0x10000 0x0 0x11cc0000 0x0 0x10000>;
	};

	usb1p_sif@11210000 {
		compatible = "mediatek,usb1p_sif";
		reg = <0x0 0x11210000 0x0 0x10000>;
	};

	usb_sif@11210000 {
		compatible = "mediatek,usb_sif";
		reg = <0x0 0x11210000 0x0 0x10000>;
	};

	utos {
		compatible = "microtrust,utos";
		interrupts = <0x0 0xf9 0x1 0x0 0xfa 0x1>;
	};

	utos_tester {
		compatible = "microtrust,tester-v1";
	};

	vdec@17040000 {
		compatible = "mediatek,vdec";
		interrupts = <0x0 0xe9 0x8>;
		reg = <0x0 0x17040000 0x0 0x10000>;
	};

	venc@17020000 {
		compatible = "mediatek,venc";
		interrupts = <0x0 0xe6 0x8>;
		reg = <0x0 0x17020000 0x0 0x10000>;
	};

	venc_gcon@17000000 {
		#clock-cells = <0x1>;
		clock-names = "MT_SCP_SYS_DIS", "MT_SCP_SYS_VCODEC", "MT_CG_MM_SMI_COMM0", "MT_CG_MM_SMI_COMM1", "MT_CG_MM_SMI_COMMON", "MT_CG_VDEC", "MT_CG_VENC";
		clocks = <0x25 0x3 0x25 0xa 0x26 0x15 0x26 0x16 0x26 0x13 0x43 0x3 0x43 0x1>;
		compatible = "mediatek,venc_gcon", "syscon";
		linux,phandle = <0x43>;
		phandle = <0x43>;
		reg = <0x0 0x17000000 0x0 0x10000>;
	};

	venc_jpg@17030000 {
		clock-names = "MT_CG_VENC_JPGENC";
		clocks = <0x43 0x2>;
		compatible = "mediatek,venc_jpg";
		interrupts = <0x0 0xe8 0x8>;
		reg = <0x0 0x17030000 0x0 0x10000>;
	};

	wifi@18000000 {
		compatible = "mediatek,wifi";
		interrupts = <0x0 0x10c 0x8>;
		reg = <0x0 0x18000000 0x0 0x100000>;
	};
};
